/* soapC.c
   Generated by gSOAP 2.7.6d from googleapi.h
   Copyright (C) 2000-2005, Robert van Engelen, Genivia Inc. All Rights Reserved.
   This part of the software is released under one of the following licenses:
   GPL, the gSOAP public license, or Genivia's license for commercial use.
*/

#include "soapH.h"
#ifdef __cplusplus
extern "C" {
#endif

SOAP_SOURCE_STAMP("@(#) soapC.c ver 2.7.6d 2006-02-17 20:44:31 GMT")


#ifndef WITH_NOGLOBAL

SOAP_FMAC3 void SOAP_FMAC4 soap_serializeheader(struct soap *soap)
{
	if (soap->header)
		soap_serialize_SOAP_ENV__Header(soap, soap->header);
}

SOAP_FMAC3 int SOAP_FMAC4 soap_putheader(struct soap *soap)
{
	if (soap->header)
	{	soap->part = SOAP_IN_HEADER;
		soap_out_SOAP_ENV__Header(soap, "SOAP-ENV:Header", 0, soap->header, NULL);
		soap->part = SOAP_END_HEADER;
	}
	return SOAP_OK;
}

SOAP_FMAC3 int SOAP_FMAC4 soap_getheader(struct soap *soap)
{
	soap->part = SOAP_IN_HEADER;
	soap->header = soap_in_SOAP_ENV__Header(soap, "SOAP-ENV:Header", NULL, NULL);
	soap->part = SOAP_END_HEADER;
	return soap->header == NULL;
}

SOAP_FMAC3 void SOAP_FMAC4 soap_fault(struct soap *soap)
{
	if (!soap->fault)
	{	soap->fault = (struct SOAP_ENV__Fault*)soap_malloc(soap, sizeof(struct SOAP_ENV__Fault));
		soap_default_SOAP_ENV__Fault(soap, soap->fault);
	}
	if (soap->version == 2 && !soap->fault->SOAP_ENV__Code)
	{	soap->fault->SOAP_ENV__Code = (struct SOAP_ENV__Code*)soap_malloc(soap, sizeof(struct SOAP_ENV__Code));
		soap_default_SOAP_ENV__Code(soap, soap->fault->SOAP_ENV__Code);
	}
	if (soap->version == 2 && !soap->fault->SOAP_ENV__Reason)
	{	soap->fault->SOAP_ENV__Reason = (struct SOAP_ENV__Reason*)soap_malloc(soap, sizeof(struct SOAP_ENV__Reason));
		soap_default_SOAP_ENV__Reason(soap, soap->fault->SOAP_ENV__Reason);
	}
}

SOAP_FMAC3 void SOAP_FMAC4 soap_serializefault(struct soap *soap)
{
	if (soap->fault)
		soap_serialize_SOAP_ENV__Fault(soap, soap->fault);
}

SOAP_FMAC3 int SOAP_FMAC4 soap_putfault(struct soap *soap)
{
	if (soap->fault)
		return soap_put_SOAP_ENV__Fault(soap, soap->fault, "SOAP-ENV:Fault", NULL);
	return SOAP_OK;
}

SOAP_FMAC3 int SOAP_FMAC4 soap_getfault(struct soap *soap)
{
	return (soap->fault = soap_get_SOAP_ENV__Fault(soap, NULL, "SOAP-ENV:Fault", NULL)) == NULL;
}

SOAP_FMAC3 const char ** SOAP_FMAC4 soap_faultcode(struct soap *soap)
{
	soap_fault(soap);
	if (soap->version == 2)
		return (const char**)&soap->fault->SOAP_ENV__Code->SOAP_ENV__Value;
	return (const char**)&soap->fault->faultcode;
}

SOAP_FMAC3 const char ** SOAP_FMAC4 soap_faultsubcode(struct soap *soap)
{
	soap_fault(soap);
	if (soap->version == 2)
	{	if (!soap->fault->SOAP_ENV__Code->SOAP_ENV__Subcode)
		{	soap->fault->SOAP_ENV__Code->SOAP_ENV__Subcode = (struct SOAP_ENV__Code*)soap_malloc(soap, sizeof(struct SOAP_ENV__Code));
			soap_default_SOAP_ENV__Code(soap, soap->fault->SOAP_ENV__Code->SOAP_ENV__Subcode);
		}
		return (const char**)&soap->fault->SOAP_ENV__Code->SOAP_ENV__Subcode->SOAP_ENV__Value;
	}
	return (const char**)&soap->fault->faultcode;
}

SOAP_FMAC3 const char ** SOAP_FMAC4 soap_faultstring(struct soap *soap)
{
	soap_fault(soap);
	if (soap->version == 2)
		return (const char**)&soap->fault->SOAP_ENV__Reason->SOAP_ENV__Text;
	return (const char**)&soap->fault->faultstring;
}

SOAP_FMAC3 const char ** SOAP_FMAC4 soap_faultdetail(struct soap *soap)
{
	soap_fault(soap);
	if (soap->version == 1)
	{	if (!soap->fault->detail)
		{	soap->fault->detail = (struct SOAP_ENV__Detail*)soap_malloc(soap, sizeof(struct SOAP_ENV__Detail));
			soap_default_SOAP_ENV__Detail(soap, soap->fault->detail);
		}
		return (const char**)&soap->fault->detail->__any;
	}
	if (!soap->fault->SOAP_ENV__Detail)
	{	soap->fault->SOAP_ENV__Detail = (struct SOAP_ENV__Detail*)soap_malloc(soap, sizeof(struct SOAP_ENV__Detail));
		soap_default_SOAP_ENV__Detail(soap, soap->fault->SOAP_ENV__Detail);
	}
	return (const char**)&soap->fault->SOAP_ENV__Detail->__any;
}

#endif

#ifndef WITH_NOIDREF
SOAP_FMAC3 int SOAP_FMAC4 soap_getindependent(struct soap *soap)
{
	int t;
	for (;;)
		if (!soap_getelement(soap, &t))
			if (soap->error || soap_ignore_element(soap))
				break;
	if (soap->error == SOAP_NO_TAG || soap->error == SOAP_EOF)
		soap->error = SOAP_OK;
	return soap->error;
}
#endif

#ifndef WITH_NOIDREF
SOAP_FMAC3 void * SOAP_FMAC4 soap_getelement(struct soap *soap, int *type)
{
	if (soap_peek_element(soap))
		return NULL;
	if (!*soap->id || !(*type = soap_lookup_type(soap, soap->id)))
		*type = soap_lookup_type(soap, soap->href);
	switch (*type)
	{
	case SOAP_TYPE_byte:
		return soap_in_byte(soap, NULL, NULL, "xsd:byte");
	case SOAP_TYPE_xsd__int:
		return soap_in_xsd__int(soap, NULL, NULL, "xsd:int");
	case SOAP_TYPE_int:
		return soap_in_int(soap, NULL, NULL, "xsd:int");
	case SOAP_TYPE_xsd__double:
		return soap_in_xsd__double(soap, NULL, NULL, "xsd:double");
	case SOAP_TYPE_double:
		return soap_in_double(soap, NULL, NULL, "xsd:double");
	case SOAP_TYPE_unsignedByte:
		return soap_in_unsignedByte(soap, NULL, NULL, "xsd:unsignedByte");
	case SOAP_TYPE_unsignedInt:
		return soap_in_unsignedInt(soap, NULL, NULL, "xsd:unsignedInt");
	case SOAP_TYPE_xsd__boolean:
		return soap_in_xsd__boolean(soap, NULL, NULL, "xsd:boolean");
	case SOAP_TYPE__Enum_1:
		return soap_in__Enum_1(soap, NULL, NULL, "Enum-1");
	case SOAP_TYPE_SOAP_ENV__Reason:
		return soap_in_SOAP_ENV__Reason(soap, NULL, NULL, "SOAP-ENV:Reason");
	case SOAP_TYPE_api__doSpellingSuggestion:
		return soap_in_api__doSpellingSuggestion(soap, NULL, NULL, "api:doSpellingSuggestion");
	case SOAP_TYPE_api__doSpellingSuggestionResponse:
		return soap_in_api__doSpellingSuggestionResponse(soap, NULL, NULL, "api:doSpellingSuggestionResponse");
	case SOAP_TYPE_api__doGetCachedPage:
		return soap_in_api__doGetCachedPage(soap, NULL, NULL, "api:doGetCachedPage");
	case SOAP_TYPE_api__doGetCachedPageResponse:
		return soap_in_api__doGetCachedPageResponse(soap, NULL, NULL, "api:doGetCachedPageResponse");
	case SOAP_TYPE_api__doGoogleSearch:
		return soap_in_api__doGoogleSearch(soap, NULL, NULL, "api:doGoogleSearch");
	case SOAP_TYPE_api__doGoogleSearchResponse:
		return soap_in_api__doGoogleSearchResponse(soap, NULL, NULL, "api:doGoogleSearchResponse");
	case SOAP_TYPE_api__GoogleSearchResult:
		return soap_in_api__GoogleSearchResult(soap, NULL, NULL, "api:GoogleSearchResult");
	case SOAP_TYPE_ResultElementArray:
		return soap_in_ResultElementArray(soap, NULL, NULL, "api:ResultElement");
	case SOAP_TYPE_api__ResultElement:
		return soap_in_api__ResultElement(soap, NULL, NULL, "api:ResultElement");
	case SOAP_TYPE_DirectoryCategoryArray:
		return soap_in_DirectoryCategoryArray(soap, NULL, NULL, "api:DirectoryCategory");
	case SOAP_TYPE_api__DirectoryCategory:
		return soap_in_api__DirectoryCategory(soap, NULL, NULL, "api:DirectoryCategory");
	case SOAP_TYPE_xsd__base64Binary:
		return soap_in_xsd__base64Binary(soap, NULL, NULL, "xsd:base64Binary");
	case SOAP_TYPE_PointerToSOAP_ENV__Reason:
		return soap_in_PointerToSOAP_ENV__Reason(soap, NULL, NULL, "SOAP-ENV:Reason");
	case SOAP_TYPE_PointerToxsd__string:
		return soap_in_PointerToxsd__string(soap, NULL, NULL, "xsd:string");
	case SOAP_TYPE_PointerToxsd__base64Binary:
		return soap_in_PointerToxsd__base64Binary(soap, NULL, NULL, "xsd:base64Binary");
	case SOAP_TYPE_PointerToapi__doGoogleSearchResponse:
		return soap_in_PointerToapi__doGoogleSearchResponse(soap, NULL, NULL, "api:doGoogleSearchResponse");
	case SOAP_TYPE_PointerToapi__ResultElement:
		return soap_in_PointerToapi__ResultElement(soap, NULL, NULL, "api:ResultElement");
	case SOAP_TYPE_PointerToapi__DirectoryCategory:
		return soap_in_PointerToapi__DirectoryCategory(soap, NULL, NULL, "api:DirectoryCategory");
	case SOAP_TYPE_PointerTounsignedByte:
		return soap_in_PointerTounsignedByte(soap, NULL, NULL, "xsd:unsignedByte");
	case SOAP_TYPE_xsd__string:
	{	char **s;
		s = soap_in_xsd__string(soap, NULL, NULL, "xsd:string");
		return s ? *s : NULL;
	}
	case SOAP_TYPE__QName:
	{	char **s;
		s = soap_in__QName(soap, NULL, NULL, "QName");
		return s ? *s : NULL;
	}
	case SOAP_TYPE_string:
	{	char **s;
		s = soap_in_string(soap, NULL, NULL, "xsd:string");
		return s ? *s : NULL;
	}
	default:
	{	const char *t = soap->type;
		if (!*t)
			t = soap->tag;
		if (!soap_match_tag(soap, t, "xsd:byte"))
		{	*type = SOAP_TYPE_byte;
			return soap_in_byte(soap, NULL, NULL, NULL);
		}
		if (!soap_match_tag(soap, t, "xsd:int"))
		{	*type = SOAP_TYPE_xsd__int;
			return soap_in_xsd__int(soap, NULL, NULL, NULL);
		}
		if (!soap_match_tag(soap, t, "xsd:int"))
		{	*type = SOAP_TYPE_int;
			return soap_in_int(soap, NULL, NULL, NULL);
		}
		if (!soap_match_tag(soap, t, "xsd:double"))
		{	*type = SOAP_TYPE_xsd__double;
			return soap_in_xsd__double(soap, NULL, NULL, NULL);
		}
		if (!soap_match_tag(soap, t, "xsd:double"))
		{	*type = SOAP_TYPE_double;
			return soap_in_double(soap, NULL, NULL, NULL);
		}
		if (!soap_match_tag(soap, t, "xsd:unsignedByte"))
		{	*type = SOAP_TYPE_unsignedByte;
			return soap_in_unsignedByte(soap, NULL, NULL, NULL);
		}
		if (!soap_match_tag(soap, t, "xsd:unsignedInt"))
		{	*type = SOAP_TYPE_unsignedInt;
			return soap_in_unsignedInt(soap, NULL, NULL, NULL);
		}
		if (!soap_match_tag(soap, t, "xsd:boolean"))
		{	*type = SOAP_TYPE_xsd__boolean;
			return soap_in_xsd__boolean(soap, NULL, NULL, NULL);
		}
		if (!soap_match_tag(soap, t, "Enum-1"))
		{	*type = SOAP_TYPE__Enum_1;
			return soap_in__Enum_1(soap, NULL, NULL, NULL);
		}
		if (!soap_match_tag(soap, t, "SOAP-ENV:Reason"))
		{	*type = SOAP_TYPE_SOAP_ENV__Reason;
			return soap_in_SOAP_ENV__Reason(soap, NULL, NULL, NULL);
		}
		if (!soap_match_tag(soap, t, "api:doSpellingSuggestion"))
		{	*type = SOAP_TYPE_api__doSpellingSuggestion;
			return soap_in_api__doSpellingSuggestion(soap, NULL, NULL, NULL);
		}
		if (!soap_match_tag(soap, t, "api:doSpellingSuggestionResponse"))
		{	*type = SOAP_TYPE_api__doSpellingSuggestionResponse;
			return soap_in_api__doSpellingSuggestionResponse(soap, NULL, NULL, NULL);
		}
		if (!soap_match_tag(soap, t, "api:doGetCachedPage"))
		{	*type = SOAP_TYPE_api__doGetCachedPage;
			return soap_in_api__doGetCachedPage(soap, NULL, NULL, NULL);
		}
		if (!soap_match_tag(soap, t, "api:doGetCachedPageResponse"))
		{	*type = SOAP_TYPE_api__doGetCachedPageResponse;
			return soap_in_api__doGetCachedPageResponse(soap, NULL, NULL, NULL);
		}
		if (!soap_match_tag(soap, t, "api:doGoogleSearch"))
		{	*type = SOAP_TYPE_api__doGoogleSearch;
			return soap_in_api__doGoogleSearch(soap, NULL, NULL, NULL);
		}
		if (!soap_match_tag(soap, t, "api:doGoogleSearchResponse"))
		{	*type = SOAP_TYPE_api__doGoogleSearchResponse;
			return soap_in_api__doGoogleSearchResponse(soap, NULL, NULL, NULL);
		}
		if (!soap_match_tag(soap, t, "api:GoogleSearchResult"))
		{	*type = SOAP_TYPE_api__GoogleSearchResult;
			return soap_in_api__GoogleSearchResult(soap, NULL, NULL, NULL);
		}
		if (*soap->arrayType && !soap_match_array(soap, "api:ResultElement"))
		{	*type = SOAP_TYPE_ResultElementArray;
			return soap_in_ResultElementArray(soap, NULL, NULL, NULL);
		}
		if (!soap_match_tag(soap, t, "api:ResultElement"))
		{	*type = SOAP_TYPE_api__ResultElement;
			return soap_in_api__ResultElement(soap, NULL, NULL, NULL);
		}
		if (*soap->arrayType && !soap_match_array(soap, "api:DirectoryCategory"))
		{	*type = SOAP_TYPE_DirectoryCategoryArray;
			return soap_in_DirectoryCategoryArray(soap, NULL, NULL, NULL);
		}
		if (!soap_match_tag(soap, t, "api:DirectoryCategory"))
		{	*type = SOAP_TYPE_api__DirectoryCategory;
			return soap_in_api__DirectoryCategory(soap, NULL, NULL, NULL);
		}
		if (!soap_match_tag(soap, t, "xsd:base64Binary"))
		{	*type = SOAP_TYPE_xsd__base64Binary;
			return soap_in_xsd__base64Binary(soap, NULL, NULL, NULL);
		}
		if (!soap_match_tag(soap, t, "xsd:string"))
		{	char **s;
			*type = SOAP_TYPE_xsd__string;
			s = soap_in_xsd__string(soap, NULL, NULL, NULL);
			return s ? *s : NULL;
		}
		if (!soap_match_tag(soap, t, "QName"))
		{	char **s;
			*type = SOAP_TYPE__QName;
			s = soap_in__QName(soap, NULL, NULL, NULL);
			return s ? *s : NULL;
		}
		if (!soap_match_tag(soap, t, "xsd:string"))
		{	char **s;
			*type = SOAP_TYPE_string;
			s = soap_in_string(soap, NULL, NULL, NULL);
			return s ? *s : NULL;
		}
	}
	}
	soap->error = SOAP_TAG_MISMATCH;
	return NULL;
}
#endif

SOAP_FMAC3 int SOAP_FMAC4 soap_ignore_element(struct soap *soap)
{
	if (!soap_peek_element(soap))
	{	int t;
		if (soap->mustUnderstand && !soap->other)
			return soap->error = SOAP_MUSTUNDERSTAND;
		if (((soap->mode & SOAP_XML_STRICT) && soap->part != SOAP_IN_HEADER) || !soap_match_tag(soap, soap->tag, "SOAP-ENV:"))
			return soap->error = SOAP_TAG_MISMATCH;
		if (!*soap->id || !soap_getelement(soap, &t))
		{	soap->peeked = 0;
			DBGLOG(TEST, SOAP_MESSAGE(fdebug, "Unknown element '%s' (level=%u, %d)\n", soap->tag, soap->level, soap->body));
			if (soap->fignore)
				soap->error = soap->fignore(soap, soap->tag);
			else
				soap->error = SOAP_OK;
			DBGLOG(TEST, if (!soap->error) SOAP_MESSAGE(fdebug, "IGNORING element '%s'\n", soap->tag));
			if (!soap->error && soap->body)
			{	soap->level++;
				while (!soap_ignore_element(soap))
					;
				if (soap->error == SOAP_NO_TAG)
					soap->error = soap_element_end_in(soap, NULL);
			}
		}
	}
	return soap->error;
}

#ifndef WITH_NOIDREF
SOAP_FMAC3 int SOAP_FMAC4 soap_putindependent(struct soap *soap)
{
	int i;
	struct soap_plist *pp;
	if (soap->version == 1 && soap->encodingStyle && !(soap->mode & (SOAP_XML_TREE | SOAP_XML_GRAPH)))
		for (i = 0; i < SOAP_PTRHASH; i++)
			for (pp = soap->pht[i]; pp; pp = pp->next)
				if (pp->mark1 == 2 || pp->mark2 == 2)
					if (soap_putelement(soap, pp->ptr, "id", pp->id, pp->type))
						return soap->error;
	return SOAP_OK;
}
#endif

#ifndef WITH_NOIDREF
SOAP_FMAC3 int SOAP_FMAC4 soap_putelement(struct soap *soap, const void *ptr, const char *tag, int id, int type)
{
	switch (type)
	{
	case SOAP_TYPE_byte:
		return soap_out_byte(soap, tag, id, (const char *)ptr, "xsd:byte");
	case SOAP_TYPE_xsd__int:
		return soap_out_xsd__int(soap, tag, id, (const int *)ptr, "xsd:int");
	case SOAP_TYPE_int:
		return soap_out_int(soap, tag, id, (const int *)ptr, "xsd:int");
	case SOAP_TYPE_xsd__double:
		return soap_out_xsd__double(soap, tag, id, (const double *)ptr, "xsd:double");
	case SOAP_TYPE_double:
		return soap_out_double(soap, tag, id, (const double *)ptr, "xsd:double");
	case SOAP_TYPE_unsignedByte:
		return soap_out_unsignedByte(soap, tag, id, (const unsigned char *)ptr, "xsd:unsignedByte");
	case SOAP_TYPE_unsignedInt:
		return soap_out_unsignedInt(soap, tag, id, (const unsigned int *)ptr, "xsd:unsignedInt");
	case SOAP_TYPE_xsd__boolean:
		return soap_out_xsd__boolean(soap, tag, id, (const enum _Enum_1 *)ptr, "xsd:boolean");
	case SOAP_TYPE__Enum_1:
		return soap_out__Enum_1(soap, tag, id, (const enum _Enum_1 *)ptr, "Enum-1");
	case SOAP_TYPE_SOAP_ENV__Reason:
		return soap_out_SOAP_ENV__Reason(soap, tag, id, (const struct SOAP_ENV__Reason *)ptr, "SOAP-ENV:Reason");
	case SOAP_TYPE_api__doSpellingSuggestion:
		return soap_out_api__doSpellingSuggestion(soap, tag, id, (const struct api__doSpellingSuggestion *)ptr, "api:doSpellingSuggestion");
	case SOAP_TYPE_api__doSpellingSuggestionResponse:
		return soap_out_api__doSpellingSuggestionResponse(soap, tag, id, (const struct api__doSpellingSuggestionResponse *)ptr, "api:doSpellingSuggestionResponse");
	case SOAP_TYPE_api__doGetCachedPage:
		return soap_out_api__doGetCachedPage(soap, tag, id, (const struct api__doGetCachedPage *)ptr, "api:doGetCachedPage");
	case SOAP_TYPE_api__doGetCachedPageResponse:
		return soap_out_api__doGetCachedPageResponse(soap, tag, id, (const struct api__doGetCachedPageResponse *)ptr, "api:doGetCachedPageResponse");
	case SOAP_TYPE_api__doGoogleSearch:
		return soap_out_api__doGoogleSearch(soap, tag, id, (const struct api__doGoogleSearch *)ptr, "api:doGoogleSearch");
	case SOAP_TYPE_api__doGoogleSearchResponse:
		return soap_out_api__doGoogleSearchResponse(soap, tag, id, (const struct api__doGoogleSearchResponse *)ptr, "api:doGoogleSearchResponse");
	case SOAP_TYPE_api__GoogleSearchResult:
		return soap_out_api__GoogleSearchResult(soap, tag, id, (const struct api__GoogleSearchResult *)ptr, "api:GoogleSearchResult");
	case SOAP_TYPE_ResultElementArray:
		return soap_out_ResultElementArray(soap, tag, id, (const struct ResultElementArray *)ptr, "api:ResultElement");
	case SOAP_TYPE_api__ResultElement:
		return soap_out_api__ResultElement(soap, tag, id, (const struct api__ResultElement *)ptr, "api:ResultElement");
	case SOAP_TYPE_DirectoryCategoryArray:
		return soap_out_DirectoryCategoryArray(soap, tag, id, (const struct DirectoryCategoryArray *)ptr, "api:DirectoryCategory");
	case SOAP_TYPE_api__DirectoryCategory:
		return soap_out_api__DirectoryCategory(soap, tag, id, (const struct api__DirectoryCategory *)ptr, "api:DirectoryCategory");
	case SOAP_TYPE_xsd__base64Binary:
		return soap_out_xsd__base64Binary(soap, tag, id, (const struct xsd__base64Binary *)ptr, "xsd:base64Binary");
	case SOAP_TYPE_PointerToSOAP_ENV__Reason:
		return soap_out_PointerToSOAP_ENV__Reason(soap, tag, id, (struct SOAP_ENV__Reason *const*)ptr, "SOAP-ENV:Reason");
	case SOAP_TYPE_PointerToxsd__string:
		return soap_out_PointerToxsd__string(soap, tag, id, (char **const*)ptr, "xsd:string");
	case SOAP_TYPE_PointerToxsd__base64Binary:
		return soap_out_PointerToxsd__base64Binary(soap, tag, id, (struct xsd__base64Binary *const*)ptr, "xsd:base64Binary");
	case SOAP_TYPE_PointerToapi__doGoogleSearchResponse:
		return soap_out_PointerToapi__doGoogleSearchResponse(soap, tag, id, (struct api__doGoogleSearchResponse *const*)ptr, "api:doGoogleSearchResponse");
	case SOAP_TYPE_PointerToapi__ResultElement:
		return soap_out_PointerToapi__ResultElement(soap, tag, id, (struct api__ResultElement *const*)ptr, "api:ResultElement");
	case SOAP_TYPE_PointerToapi__DirectoryCategory:
		return soap_out_PointerToapi__DirectoryCategory(soap, tag, id, (struct api__DirectoryCategory *const*)ptr, "api:DirectoryCategory");
	case SOAP_TYPE_PointerTounsignedByte:
		return soap_out_PointerTounsignedByte(soap, tag, id, (unsigned char *const*)ptr, "xsd:unsignedByte");
	case SOAP_TYPE_xsd__string:
		return soap_out_string(soap, tag, id, (char**)&ptr, "xsd:string");
	case SOAP_TYPE__QName:
		return soap_out_string(soap, "QName", id, (char**)&ptr, NULL);
	case SOAP_TYPE_string:
		return soap_out_string(soap, tag, id, (char**)&ptr, "xsd:string");
	}
	return SOAP_OK;
}
#endif

#ifndef WITH_NOIDREF
SOAP_FMAC3 void SOAP_FMAC4 soap_markelement(struct soap *soap, const void *ptr, int type)
{
	(void)soap; (void)ptr; (void)type; /* appease -Wall -Werror */
	switch (type)
	{
	case SOAP_TYPE_SOAP_ENV__Reason:
		soap_serialize_SOAP_ENV__Reason(soap, (const struct SOAP_ENV__Reason *)ptr);
		break;
	case SOAP_TYPE_api__doSpellingSuggestion:
		soap_serialize_api__doSpellingSuggestion(soap, (const struct api__doSpellingSuggestion *)ptr);
		break;
	case SOAP_TYPE_api__doSpellingSuggestionResponse:
		soap_serialize_api__doSpellingSuggestionResponse(soap, (const struct api__doSpellingSuggestionResponse *)ptr);
		break;
	case SOAP_TYPE_api__doGetCachedPage:
		soap_serialize_api__doGetCachedPage(soap, (const struct api__doGetCachedPage *)ptr);
		break;
	case SOAP_TYPE_api__doGetCachedPageResponse:
		soap_serialize_api__doGetCachedPageResponse(soap, (const struct api__doGetCachedPageResponse *)ptr);
		break;
	case SOAP_TYPE_api__doGoogleSearch:
		soap_serialize_api__doGoogleSearch(soap, (const struct api__doGoogleSearch *)ptr);
		break;
	case SOAP_TYPE_api__doGoogleSearchResponse:
		soap_serialize_api__doGoogleSearchResponse(soap, (const struct api__doGoogleSearchResponse *)ptr);
		break;
	case SOAP_TYPE_api__GoogleSearchResult:
		soap_serialize_api__GoogleSearchResult(soap, (const struct api__GoogleSearchResult *)ptr);
		break;
	case SOAP_TYPE_ResultElementArray:
		soap_serialize_ResultElementArray(soap, (const struct ResultElementArray *)ptr);
		break;
	case SOAP_TYPE_api__ResultElement:
		soap_serialize_api__ResultElement(soap, (const struct api__ResultElement *)ptr);
		break;
	case SOAP_TYPE_DirectoryCategoryArray:
		soap_serialize_DirectoryCategoryArray(soap, (const struct DirectoryCategoryArray *)ptr);
		break;
	case SOAP_TYPE_api__DirectoryCategory:
		soap_serialize_api__DirectoryCategory(soap, (const struct api__DirectoryCategory *)ptr);
		break;
	case SOAP_TYPE_xsd__base64Binary:
		soap_serialize_xsd__base64Binary(soap, (const struct xsd__base64Binary *)ptr);
		break;
	case SOAP_TYPE_PointerToSOAP_ENV__Reason:
		soap_serialize_PointerToSOAP_ENV__Reason(soap, (struct SOAP_ENV__Reason *const*)ptr);
		break;
	case SOAP_TYPE_PointerToxsd__string:
		soap_serialize_PointerToxsd__string(soap, (char **const*)ptr);
		break;
	case SOAP_TYPE_PointerToxsd__base64Binary:
		soap_serialize_PointerToxsd__base64Binary(soap, (struct xsd__base64Binary *const*)ptr);
		break;
	case SOAP_TYPE_PointerToapi__doGoogleSearchResponse:
		soap_serialize_PointerToapi__doGoogleSearchResponse(soap, (struct api__doGoogleSearchResponse *const*)ptr);
		break;
	case SOAP_TYPE_PointerToapi__ResultElement:
		soap_serialize_PointerToapi__ResultElement(soap, (struct api__ResultElement *const*)ptr);
		break;
	case SOAP_TYPE_PointerToapi__DirectoryCategory:
		soap_serialize_PointerToapi__DirectoryCategory(soap, (struct api__DirectoryCategory *const*)ptr);
		break;
	case SOAP_TYPE_PointerTounsignedByte:
		soap_serialize_PointerTounsignedByte(soap, (unsigned char *const*)ptr);
		break;
	case SOAP_TYPE_xsd__string:
		soap_serialize_string(soap, (char**)&ptr);
		break;
	case SOAP_TYPE__QName:
		soap_serialize_string(soap, (char**)&ptr);
		break;
	case SOAP_TYPE_string:
		soap_serialize_string(soap, (char**)&ptr);
		break;
	}
}
#endif

SOAP_FMAC3 void SOAP_FMAC4 soap_default_byte(struct soap *soap, char *a)
{	(void)soap; /* appease -Wall -Werror */
#ifdef SOAP_DEFAULT_byte
	*a = SOAP_DEFAULT_byte;
#else
	*a = (char)0;
#endif
}

SOAP_FMAC3 int SOAP_FMAC4 soap_put_byte(struct soap *soap, const char *a, const char *tag, const char *type)
{
	register int id = soap_embed(soap, (void*)a, NULL, 0, tag, SOAP_TYPE_byte);
	if (soap_out_byte(soap, tag, id, a, type))
		return soap->error;
	return soap_putindependent(soap);
}

SOAP_FMAC3 int SOAP_FMAC4 soap_out_byte(struct soap *soap, const char *tag, int id, const char *a, const char *type)
{
	return soap_outbyte(soap, tag, id, a, type, SOAP_TYPE_byte);
}

SOAP_FMAC3 char * SOAP_FMAC4 soap_get_byte(struct soap *soap, char *p, const char *tag, const char *type)
{
	if ((p = soap_in_byte(soap, tag, p, type)))
		soap_getindependent(soap);
	return p;
}

SOAP_FMAC3 char * SOAP_FMAC4 soap_in_byte(struct soap *soap, const char *tag, char *a, const char *type)
{
	return soap_inbyte(soap, tag, a, type, SOAP_TYPE_byte);
}

SOAP_FMAC3 void SOAP_FMAC4 soap_default_xsd__int(struct soap *soap, int *a)
{	soap_default_int(soap, a);
}

SOAP_FMAC3 int SOAP_FMAC4 soap_put_xsd__int(struct soap *soap, const int *a, const char *tag, const char *type)
{
	register int id = soap_embed(soap, (void*)a, NULL, 0, tag, SOAP_TYPE_xsd__int);
	if (soap_out_xsd__int(soap, tag, id, a, type))
		return soap->error;
	return soap_putindependent(soap);
}

SOAP_FMAC3 int SOAP_FMAC4 soap_out_xsd__int(struct soap *soap, const char *tag, int id, const int *a, const char *type)
{
	return soap_outint(soap, tag, id, a, type, SOAP_TYPE_xsd__int);
}

SOAP_FMAC3 int * SOAP_FMAC4 soap_get_xsd__int(struct soap *soap, int *p, const char *tag, const char *type)
{
	if ((p = soap_in_xsd__int(soap, tag, p, type)))
		soap_getindependent(soap);
	return p;
}

SOAP_FMAC3 int * SOAP_FMAC4 soap_in_xsd__int(struct soap *soap, const char *tag, int *a, const char *type)
{
	return soap_inint(soap, tag, a, type, SOAP_TYPE_xsd__int);
}

SOAP_FMAC3 void SOAP_FMAC4 soap_default_int(struct soap *soap, int *a)
{	(void)soap; /* appease -Wall -Werror */
#ifdef SOAP_DEFAULT_int
	*a = SOAP_DEFAULT_int;
#else
	*a = (int)0;
#endif
}

SOAP_FMAC3 int SOAP_FMAC4 soap_put_int(struct soap *soap, const int *a, const char *tag, const char *type)
{
	register int id = soap_embed(soap, (void*)a, NULL, 0, tag, SOAP_TYPE_int);
	if (soap_out_int(soap, tag, id, a, type))
		return soap->error;
	return soap_putindependent(soap);
}

SOAP_FMAC3 int SOAP_FMAC4 soap_out_int(struct soap *soap, const char *tag, int id, const int *a, const char *type)
{
	return soap_outint(soap, tag, id, a, type, SOAP_TYPE_int);
}

SOAP_FMAC3 int * SOAP_FMAC4 soap_get_int(struct soap *soap, int *p, const char *tag, const char *type)
{
	if ((p = soap_in_int(soap, tag, p, type)))
		soap_getindependent(soap);
	return p;
}

SOAP_FMAC3 int * SOAP_FMAC4 soap_in_int(struct soap *soap, const char *tag, int *a, const char *type)
{
	return soap_inint(soap, tag, a, type, SOAP_TYPE_int);
}

SOAP_FMAC3 void SOAP_FMAC4 soap_default_xsd__double(struct soap *soap, double *a)
{	soap_default_double(soap, a);
}

SOAP_FMAC3 int SOAP_FMAC4 soap_put_xsd__double(struct soap *soap, const double *a, const char *tag, const char *type)
{
	register int id = soap_embed(soap, (void*)a, NULL, 0, tag, SOAP_TYPE_xsd__double);
	if (soap_out_xsd__double(soap, tag, id, a, type))
		return soap->error;
	return soap_putindependent(soap);
}

SOAP_FMAC3 int SOAP_FMAC4 soap_out_xsd__double(struct soap *soap, const char *tag, int id, const double *a, const char *type)
{
	return soap_outdouble(soap, tag, id, a, type, SOAP_TYPE_xsd__double);
}

SOAP_FMAC3 double * SOAP_FMAC4 soap_get_xsd__double(struct soap *soap, double *p, const char *tag, const char *type)
{
	if ((p = soap_in_xsd__double(soap, tag, p, type)))
		soap_getindependent(soap);
	return p;
}

SOAP_FMAC3 double * SOAP_FMAC4 soap_in_xsd__double(struct soap *soap, const char *tag, double *a, const char *type)
{
	return soap_indouble(soap, tag, a, type, SOAP_TYPE_xsd__double);
}

SOAP_FMAC3 void SOAP_FMAC4 soap_default_double(struct soap *soap, double *a)
{	(void)soap; /* appease -Wall -Werror */
#ifdef SOAP_DEFAULT_double
	*a = SOAP_DEFAULT_double;
#else
	*a = (double)0;
#endif
}

SOAP_FMAC3 int SOAP_FMAC4 soap_put_double(struct soap *soap, const double *a, const char *tag, const char *type)
{
	register int id = soap_embed(soap, (void*)a, NULL, 0, tag, SOAP_TYPE_double);
	if (soap_out_double(soap, tag, id, a, type))
		return soap->error;
	return soap_putindependent(soap);
}

SOAP_FMAC3 int SOAP_FMAC4 soap_out_double(struct soap *soap, const char *tag, int id, const double *a, const char *type)
{
	return soap_outdouble(soap, tag, id, a, type, SOAP_TYPE_double);
}

SOAP_FMAC3 double * SOAP_FMAC4 soap_get_double(struct soap *soap, double *p, const char *tag, const char *type)
{
	if ((p = soap_in_double(soap, tag, p, type)))
		soap_getindependent(soap);
	return p;
}

SOAP_FMAC3 double * SOAP_FMAC4 soap_in_double(struct soap *soap, const char *tag, double *a, const char *type)
{
	return soap_indouble(soap, tag, a, type, SOAP_TYPE_double);
}

SOAP_FMAC3 void SOAP_FMAC4 soap_default_unsignedByte(struct soap *soap, unsigned char *a)
{	(void)soap; /* appease -Wall -Werror */
#ifdef SOAP_DEFAULT_unsignedByte
	*a = SOAP_DEFAULT_unsignedByte;
#else
	*a = (unsigned char)0;
#endif
}

SOAP_FMAC3 int SOAP_FMAC4 soap_put_unsignedByte(struct soap *soap, const unsigned char *a, const char *tag, const char *type)
{
	register int id = soap_embed(soap, (void*)a, NULL, 0, tag, SOAP_TYPE_unsignedByte);
	if (soap_out_unsignedByte(soap, tag, id, a, type))
		return soap->error;
	return soap_putindependent(soap);
}

SOAP_FMAC3 int SOAP_FMAC4 soap_out_unsignedByte(struct soap *soap, const char *tag, int id, const unsigned char *a, const char *type)
{
	return soap_outunsignedByte(soap, tag, id, a, type, SOAP_TYPE_unsignedByte);
}

SOAP_FMAC3 unsigned char * SOAP_FMAC4 soap_get_unsignedByte(struct soap *soap, unsigned char *p, const char *tag, const char *type)
{
	if ((p = soap_in_unsignedByte(soap, tag, p, type)))
		soap_getindependent(soap);
	return p;
}

SOAP_FMAC3 unsigned char * SOAP_FMAC4 soap_in_unsignedByte(struct soap *soap, const char *tag, unsigned char *a, const char *type)
{
	return soap_inunsignedByte(soap, tag, a, type, SOAP_TYPE_unsignedByte);
}

SOAP_FMAC3 void SOAP_FMAC4 soap_default_unsignedInt(struct soap *soap, unsigned int *a)
{	(void)soap; /* appease -Wall -Werror */
#ifdef SOAP_DEFAULT_unsignedInt
	*a = SOAP_DEFAULT_unsignedInt;
#else
	*a = (unsigned int)0;
#endif
}

SOAP_FMAC3 int SOAP_FMAC4 soap_put_unsignedInt(struct soap *soap, const unsigned int *a, const char *tag, const char *type)
{
	register int id = soap_embed(soap, (void*)a, NULL, 0, tag, SOAP_TYPE_unsignedInt);
	if (soap_out_unsignedInt(soap, tag, id, a, type))
		return soap->error;
	return soap_putindependent(soap);
}

SOAP_FMAC3 int SOAP_FMAC4 soap_out_unsignedInt(struct soap *soap, const char *tag, int id, const unsigned int *a, const char *type)
{
	return soap_outunsignedInt(soap, tag, id, a, type, SOAP_TYPE_unsignedInt);
}

SOAP_FMAC3 unsigned int * SOAP_FMAC4 soap_get_unsignedInt(struct soap *soap, unsigned int *p, const char *tag, const char *type)
{
	if ((p = soap_in_unsignedInt(soap, tag, p, type)))
		soap_getindependent(soap);
	return p;
}

SOAP_FMAC3 unsigned int * SOAP_FMAC4 soap_in_unsignedInt(struct soap *soap, const char *tag, unsigned int *a, const char *type)
{
	return soap_inunsignedInt(soap, tag, a, type, SOAP_TYPE_unsignedInt);
}

SOAP_FMAC3 void SOAP_FMAC4 soap_default_xsd__boolean(struct soap *soap, enum _Enum_1 *a)
{	soap_default__Enum_1(soap, a);
}

SOAP_FMAC3 int SOAP_FMAC4 soap_put_xsd__boolean(struct soap *soap, const enum _Enum_1 *a, const char *tag, const char *type)
{
	register int id = soap_embed(soap, (void*)a, NULL, 0, tag, SOAP_TYPE_xsd__boolean);
	if (soap_out_xsd__boolean(soap, tag, id, a, type))
		return soap->error;
	return soap_putindependent(soap);
}

SOAP_FMAC3S const char* SOAP_FMAC4S soap_xsd__boolean2s(struct soap *soap, enum _Enum_1 n)
{	return soap__Enum_12s(soap, n);
}

SOAP_FMAC3 int SOAP_FMAC4 soap_out_xsd__boolean(struct soap *soap, const char *tag, int id, const enum _Enum_1 *a, const char *type)
{	soap_element_begin_out(soap, tag, soap_embedded_id(soap, id, a, SOAP_TYPE_xsd__boolean), type);
	soap_send(soap, soap_xsd__boolean2s(soap, *a));
	return soap_element_end_out(soap, tag);
}

SOAP_FMAC3 enum _Enum_1 * SOAP_FMAC4 soap_get_xsd__boolean(struct soap *soap, enum _Enum_1 *p, const char *tag, const char *type)
{
	if ((p = soap_in_xsd__boolean(soap, tag, p, type)))
		soap_getindependent(soap);
	return p;
}

SOAP_FMAC3S int SOAP_FMAC4S soap_s2xsd__boolean(struct soap *soap, const char *s, enum _Enum_1 *a)
{
	return soap_s2_Enum_1(soap, s, a);
}

SOAP_FMAC3 enum _Enum_1 * SOAP_FMAC4 soap_in_xsd__boolean(struct soap *soap, const char *tag, enum _Enum_1 *a, const char *type)
{
	if (soap_element_begin_in(soap, tag, 0))
		return NULL;
	if (*soap->type && soap_match_tag(soap, soap->type, type) && soap_match_tag(soap, soap->type, "Enum-1"))
	{	soap->error = SOAP_TYPE;
		return NULL;
	}
	a = (enum _Enum_1 *)soap_id_enter(soap, soap->id, a, SOAP_TYPE_xsd__boolean, sizeof(enum _Enum_1), 0, NULL, NULL, NULL);
	if (!a)
		return NULL;
	if (soap->body && !*soap->href)
	{	if (!a || soap_s2xsd__boolean(soap, soap_value(soap), a) || soap_element_end_in(soap, tag))
			return NULL;
	}
	else
	{	a = (enum _Enum_1 *)soap_id_forward(soap, soap->href, (void**)a, SOAP_TYPE_xsd__boolean, 0, sizeof(enum _Enum_1), 0, NULL);
		if (soap->body && soap_element_end_in(soap, tag))
			return NULL;
	}
	return a;
}

SOAP_FMAC3 void SOAP_FMAC4 soap_default__Enum_1(struct soap *soap, enum _Enum_1 *a)
{	(void)soap; /* appease -Wall -Werror */
#ifdef SOAP_DEFAULT__Enum_1
	*a = SOAP_DEFAULT__Enum_1;
#else
	*a = (enum _Enum_1)0;
#endif
}

SOAP_FMAC3 int SOAP_FMAC4 soap_put__Enum_1(struct soap *soap, const enum _Enum_1 *a, const char *tag, const char *type)
{
	register int id = soap_embed(soap, (void*)a, NULL, 0, tag, SOAP_TYPE__Enum_1);
	if (soap_out__Enum_1(soap, tag, id, a, type))
		return soap->error;
	return soap_putindependent(soap);
}

static const struct soap_code_map soap_codes__Enum_1[] =
{	{ (long)false_, "false" },
	{ (long)true_, "true" },
	{ 0, NULL }
};

SOAP_FMAC3S const char* SOAP_FMAC4S soap__Enum_12s(struct soap *soap, enum _Enum_1 n)
{	const char *s = soap_str_code(soap_codes__Enum_1, (long)n);
	if (s)
		return s;
	return soap_long2s(soap, (long)n);
}

SOAP_FMAC3 int SOAP_FMAC4 soap_out__Enum_1(struct soap *soap, const char *tag, int id, const enum _Enum_1 *a, const char *type)
{	soap_element_begin_out(soap, tag, soap_embedded_id(soap, id, a, SOAP_TYPE__Enum_1), type);
	soap_send(soap, soap__Enum_12s(soap, *a));
	return soap_element_end_out(soap, tag);
}

SOAP_FMAC3 enum _Enum_1 * SOAP_FMAC4 soap_get__Enum_1(struct soap *soap, enum _Enum_1 *p, const char *tag, const char *type)
{
	if ((p = soap_in__Enum_1(soap, tag, p, type)))
		soap_getindependent(soap);
	return p;
}

SOAP_FMAC3S int SOAP_FMAC4S soap_s2_Enum_1(struct soap *soap, const char *s, enum _Enum_1 *a)
{
	const struct soap_code_map *map;
	if (!s)
		return SOAP_OK;
	map = soap_code(soap_codes__Enum_1, s);
	if (map)
		*a = (enum _Enum_1)map->code;
	else
	{	long n;
		if (soap_s2long(soap, s, &n) || ((soap->mode & SOAP_XML_STRICT) && (n < 0 || n > 0)))
			return soap->error = SOAP_TYPE;
		*a = (enum _Enum_1)n;
	}
	return SOAP_OK;
}

SOAP_FMAC3 enum _Enum_1 * SOAP_FMAC4 soap_in__Enum_1(struct soap *soap, const char *tag, enum _Enum_1 *a, const char *type)
{
	if (soap_element_begin_in(soap, tag, 0))
		return NULL;
	if (*soap->type && soap_match_tag(soap, soap->type, type))
	{	soap->error = SOAP_TYPE;
		return NULL;
	}
	a = (enum _Enum_1 *)soap_id_enter(soap, soap->id, a, SOAP_TYPE__Enum_1, sizeof(enum _Enum_1), 0, NULL, NULL, NULL);
	if (!a)
		return NULL;
	if (soap->body && !*soap->href)
	{	if (!a || soap_s2_Enum_1(soap, soap_value(soap), a) || soap_element_end_in(soap, tag))
			return NULL;
	}
	else
	{	a = (enum _Enum_1 *)soap_id_forward(soap, soap->href, (void**)a, SOAP_TYPE__Enum_1, 0, sizeof(enum _Enum_1), 0, NULL);
		if (soap->body && soap_element_end_in(soap, tag))
			return NULL;
	}
	return a;
}

#ifndef WITH_NOGLOBAL

SOAP_FMAC3 void SOAP_FMAC4 soap_serialize_SOAP_ENV__Fault(struct soap *soap, const struct SOAP_ENV__Fault *a)
{
	(void)soap; (void)a; /* appease -Wall -Werror */
	soap_serialize__QName(soap, &a->faultcode);
	soap_serialize_string(soap, &a->faultstring);
	soap_serialize_string(soap, &a->faultactor);
	soap_serialize_PointerToSOAP_ENV__Detail(soap, &a->detail);
	soap_serialize_PointerToSOAP_ENV__Code(soap, &a->SOAP_ENV__Code);
	soap_serialize_PointerToSOAP_ENV__Reason(soap, &a->SOAP_ENV__Reason);
	soap_serialize_string(soap, &a->SOAP_ENV__Node);
	soap_serialize_string(soap, &a->SOAP_ENV__Role);
	soap_serialize_PointerToSOAP_ENV__Detail(soap, &a->SOAP_ENV__Detail);
}

SOAP_FMAC3 void SOAP_FMAC4 soap_default_SOAP_ENV__Fault(struct soap *soap, struct SOAP_ENV__Fault *a)
{
	(void)soap; (void)a; /* appease -Wall -Werror */
	soap_default__QName(soap, &a->faultcode);
	soap_default_string(soap, &a->faultstring);
	soap_default_string(soap, &a->faultactor);
	a->detail = NULL;
	a->SOAP_ENV__Code = NULL;
	a->SOAP_ENV__Reason = NULL;
	soap_default_string(soap, &a->SOAP_ENV__Node);
	soap_default_string(soap, &a->SOAP_ENV__Role);
	a->SOAP_ENV__Detail = NULL;
}

SOAP_FMAC3 int SOAP_FMAC4 soap_put_SOAP_ENV__Fault(struct soap *soap, const struct SOAP_ENV__Fault *a, const char *tag, const char *type)
{
	register int id = soap_embed(soap, (void*)a, NULL, 0, tag, SOAP_TYPE_SOAP_ENV__Fault);
	if (soap_out_SOAP_ENV__Fault(soap, tag, id, a, type))
		return soap->error;
	return soap_putindependent(soap);
}

SOAP_FMAC3 int SOAP_FMAC4 soap_out_SOAP_ENV__Fault(struct soap *soap, const char *tag, int id, const struct SOAP_ENV__Fault *a, const char *type)
{
	const char *soap_tmp_faultcode = soap_QName2s(soap, a->faultcode);
	soap_element_begin_out(soap, tag, soap_embedded_id(soap, id, a, SOAP_TYPE_SOAP_ENV__Fault), type);
	soap_out__QName(soap, "faultcode", -1, (char*const*)&soap_tmp_faultcode, "");
	soap_out_string(soap, "faultstring", -1, &a->faultstring, "");
	soap_out_string(soap, "faultactor", -1, &a->faultactor, "");
	soap_out_PointerToSOAP_ENV__Detail(soap, "detail", -1, &a->detail, "");
	soap_out_PointerToSOAP_ENV__Code(soap, "SOAP-ENV:Code", -1, &a->SOAP_ENV__Code, "");
	soap_out_PointerToSOAP_ENV__Reason(soap, "SOAP-ENV:Reason", -1, &a->SOAP_ENV__Reason, "");
	soap_out_string(soap, "SOAP-ENV:Node", -1, &a->SOAP_ENV__Node, "");
	soap_out_string(soap, "SOAP-ENV:Role", -1, &a->SOAP_ENV__Role, "");
	soap_out_PointerToSOAP_ENV__Detail(soap, "SOAP-ENV:Detail", -1, &a->SOAP_ENV__Detail, "");
	soap_element_end_out(soap, tag);
	return SOAP_OK;
}

SOAP_FMAC3 struct SOAP_ENV__Fault * SOAP_FMAC4 soap_get_SOAP_ENV__Fault(struct soap *soap, struct SOAP_ENV__Fault *p, const char *tag, const char *type)
{
	if ((p = soap_in_SOAP_ENV__Fault(soap, tag, p, type)))
		soap_getindependent(soap);
	return p;
}

SOAP_FMAC3 struct SOAP_ENV__Fault * SOAP_FMAC4 soap_in_SOAP_ENV__Fault(struct soap *soap, const char *tag, struct SOAP_ENV__Fault *a, const char *type)
{
	short soap_flag_faultcode = 1, soap_flag_faultstring = 1, soap_flag_faultactor = 1, soap_flag_detail = 1, soap_flag_SOAP_ENV__Code = 1, soap_flag_SOAP_ENV__Reason = 1, soap_flag_SOAP_ENV__Node = 1, soap_flag_SOAP_ENV__Role = 1, soap_flag_SOAP_ENV__Detail = 1;
	if (soap_element_begin_in(soap, tag, 0))
		return NULL;
	if (*soap->type && soap_match_tag(soap, soap->type, type))
	{	soap->error = SOAP_TYPE;
		return NULL;
	}
	a = (struct SOAP_ENV__Fault *)soap_id_enter(soap, soap->id, a, SOAP_TYPE_SOAP_ENV__Fault, sizeof(struct SOAP_ENV__Fault), 0, NULL, NULL, NULL);
	if (!a)
		return NULL;
	soap_default_SOAP_ENV__Fault(soap, a);
	if (soap->body && !*soap->href)
	{
		for (;;)
		{	soap->error = SOAP_TAG_MISMATCH;
			if (soap_flag_faultcode && (soap->error == SOAP_TAG_MISMATCH || soap->error == SOAP_NO_TAG))
				if (soap_in__QName(soap, "faultcode", &a->faultcode, ""))
				{	soap_flag_faultcode--;
					continue;
				}
			if (soap_flag_faultstring && (soap->error == SOAP_TAG_MISMATCH || soap->error == SOAP_NO_TAG))
				if (soap_in_string(soap, "faultstring", &a->faultstring, "xsd:string"))
				{	soap_flag_faultstring--;
					continue;
				}
			if (soap_flag_faultactor && (soap->error == SOAP_TAG_MISMATCH || soap->error == SOAP_NO_TAG))
				if (soap_in_string(soap, "faultactor", &a->faultactor, "xsd:string"))
				{	soap_flag_faultactor--;
					continue;
				}
			if (soap_flag_detail && soap->error == SOAP_TAG_MISMATCH)
				if (soap_in_PointerToSOAP_ENV__Detail(soap, "detail", &a->detail, ""))
				{	soap_flag_detail--;
					continue;
				}
			if (soap_flag_SOAP_ENV__Code && soap->error == SOAP_TAG_MISMATCH)
				if (soap_in_PointerToSOAP_ENV__Code(soap, "SOAP-ENV:Code", &a->SOAP_ENV__Code, ""))
				{	soap_flag_SOAP_ENV__Code--;
					continue;
				}
			if (soap_flag_SOAP_ENV__Reason && soap->error == SOAP_TAG_MISMATCH)
				if (soap_in_PointerToSOAP_ENV__Reason(soap, "SOAP-ENV:Reason", &a->SOAP_ENV__Reason, ""))
				{	soap_flag_SOAP_ENV__Reason--;
					continue;
				}
			if (soap_flag_SOAP_ENV__Node && (soap->error == SOAP_TAG_MISMATCH || soap->error == SOAP_NO_TAG))
				if (soap_in_string(soap, "SOAP-ENV:Node", &a->SOAP_ENV__Node, "xsd:string"))
				{	soap_flag_SOAP_ENV__Node--;
					continue;
				}
			if (soap_flag_SOAP_ENV__Role && (soap->error == SOAP_TAG_MISMATCH || soap->error == SOAP_NO_TAG))
				if (soap_in_string(soap, "SOAP-ENV:Role", &a->SOAP_ENV__Role, "xsd:string"))
				{	soap_flag_SOAP_ENV__Role--;
					continue;
				}
			if (soap_flag_SOAP_ENV__Detail && soap->error == SOAP_TAG_MISMATCH)
				if (soap_in_PointerToSOAP_ENV__Detail(soap, "SOAP-ENV:Detail", &a->SOAP_ENV__Detail, ""))
				{	soap_flag_SOAP_ENV__Detail--;
					continue;
				}
			if (soap->error == SOAP_TAG_MISMATCH)
				soap->error = soap_ignore_element(soap);
			if (soap->error == SOAP_NO_TAG)
				break;
			if (soap->error)
				return NULL;
		}
		if (soap_element_end_in(soap, tag))
			return NULL;
	}
	else
	{	a = (struct SOAP_ENV__Fault *)soap_id_forward(soap, soap->href, (void**)a, SOAP_TYPE_SOAP_ENV__Fault, 0, sizeof(struct SOAP_ENV__Fault), 0, NULL);
		if (soap->body && soap_element_end_in(soap, tag))
			return NULL;
	}
	return a;
}

#endif

SOAP_FMAC3 void SOAP_FMAC4 soap_serialize_SOAP_ENV__Reason(struct soap *soap, const struct SOAP_ENV__Reason *a)
{
	(void)soap; (void)a; /* appease -Wall -Werror */
	soap_serialize_string(soap, &a->SOAP_ENV__Text);
}

SOAP_FMAC3 void SOAP_FMAC4 soap_default_SOAP_ENV__Reason(struct soap *soap, struct SOAP_ENV__Reason *a)
{
	(void)soap; (void)a; /* appease -Wall -Werror */
	soap_default_string(soap, &a->SOAP_ENV__Text);
}

SOAP_FMAC3 int SOAP_FMAC4 soap_put_SOAP_ENV__Reason(struct soap *soap, const struct SOAP_ENV__Reason *a, const char *tag, const char *type)
{
	register int id = soap_embed(soap, (void*)a, NULL, 0, tag, SOAP_TYPE_SOAP_ENV__Reason);
	if (soap_out_SOAP_ENV__Reason(soap, tag, id, a, type))
		return soap->error;
	return soap_putindependent(soap);
}

SOAP_FMAC3 int SOAP_FMAC4 soap_out_SOAP_ENV__Reason(struct soap *soap, const char *tag, int id, const struct SOAP_ENV__Reason *a, const char *type)
{
	soap_element_begin_out(soap, tag, soap_embedded_id(soap, id, a, SOAP_TYPE_SOAP_ENV__Reason), type);
	soap_out_string(soap, "SOAP-ENV:Text", -1, &a->SOAP_ENV__Text, "");
	soap_element_end_out(soap, tag);
	return SOAP_OK;
}

SOAP_FMAC3 struct SOAP_ENV__Reason * SOAP_FMAC4 soap_get_SOAP_ENV__Reason(struct soap *soap, struct SOAP_ENV__Reason *p, const char *tag, const char *type)
{
	if ((p = soap_in_SOAP_ENV__Reason(soap, tag, p, type)))
		soap_getindependent(soap);
	return p;
}

SOAP_FMAC3 struct SOAP_ENV__Reason * SOAP_FMAC4 soap_in_SOAP_ENV__Reason(struct soap *soap, const char *tag, struct SOAP_ENV__Reason *a, const char *type)
{
	short soap_flag_SOAP_ENV__Text = 1;
	if (soap_element_begin_in(soap, tag, 0))
		return NULL;
	if (*soap->type && soap_match_tag(soap, soap->type, type))
	{	soap->error = SOAP_TYPE;
		return NULL;
	}
	a = (struct SOAP_ENV__Reason *)soap_id_enter(soap, soap->id, a, SOAP_TYPE_SOAP_ENV__Reason, sizeof(struct SOAP_ENV__Reason), 0, NULL, NULL, NULL);
	if (!a)
		return NULL;
	soap_default_SOAP_ENV__Reason(soap, a);
	if (soap->body && !*soap->href)
	{
		for (;;)
		{	soap->error = SOAP_TAG_MISMATCH;
			if (soap_flag_SOAP_ENV__Text && (soap->error == SOAP_TAG_MISMATCH || soap->error == SOAP_NO_TAG))
				if (soap_in_string(soap, "SOAP-ENV:Text", &a->SOAP_ENV__Text, "xsd:string"))
				{	soap_flag_SOAP_ENV__Text--;
					continue;
				}
			if (soap->error == SOAP_TAG_MISMATCH)
				soap->error = soap_ignore_element(soap);
			if (soap->error == SOAP_NO_TAG)
				break;
			if (soap->error)
				return NULL;
		}
		if (soap_element_end_in(soap, tag))
			return NULL;
	}
	else
	{	a = (struct SOAP_ENV__Reason *)soap_id_forward(soap, soap->href, (void**)a, SOAP_TYPE_SOAP_ENV__Reason, 0, sizeof(struct SOAP_ENV__Reason), 0, NULL);
		if (soap->body && soap_element_end_in(soap, tag))
			return NULL;
	}
	return a;
}

#ifndef WITH_NOGLOBAL

SOAP_FMAC3 void SOAP_FMAC4 soap_serialize_SOAP_ENV__Detail(struct soap *soap, const struct SOAP_ENV__Detail *a)
{
	(void)soap; (void)a; /* appease -Wall -Werror */
	soap_markelement(soap, a->fault, a->__type);
}

SOAP_FMAC3 void SOAP_FMAC4 soap_default_SOAP_ENV__Detail(struct soap *soap, struct SOAP_ENV__Detail *a)
{
	(void)soap; (void)a; /* appease -Wall -Werror */
	a->__type = 0;
	a->fault = NULL;
	a->__any = NULL;
}

SOAP_FMAC3 int SOAP_FMAC4 soap_put_SOAP_ENV__Detail(struct soap *soap, const struct SOAP_ENV__Detail *a, const char *tag, const char *type)
{
	register int id = soap_embed(soap, (void*)a, NULL, 0, tag, SOAP_TYPE_SOAP_ENV__Detail);
	if (soap_out_SOAP_ENV__Detail(soap, tag, id, a, type))
		return soap->error;
	return soap_putindependent(soap);
}

SOAP_FMAC3 int SOAP_FMAC4 soap_out_SOAP_ENV__Detail(struct soap *soap, const char *tag, int id, const struct SOAP_ENV__Detail *a, const char *type)
{
	soap_element_begin_out(soap, tag, soap_embedded_id(soap, id, a, SOAP_TYPE_SOAP_ENV__Detail), type);
	soap_putelement(soap, a->fault, "fault", -1, a->__type);
	soap_outliteral(soap, "-any", &a->__any);
	soap_element_end_out(soap, tag);
	return SOAP_OK;
}

SOAP_FMAC3 struct SOAP_ENV__Detail * SOAP_FMAC4 soap_get_SOAP_ENV__Detail(struct soap *soap, struct SOAP_ENV__Detail *p, const char *tag, const char *type)
{
	if ((p = soap_in_SOAP_ENV__Detail(soap, tag, p, type)))
		soap_getindependent(soap);
	return p;
}

SOAP_FMAC3 struct SOAP_ENV__Detail * SOAP_FMAC4 soap_in_SOAP_ENV__Detail(struct soap *soap, const char *tag, struct SOAP_ENV__Detail *a, const char *type)
{
	short soap_flag_fault = 1, soap_flag___any = 1;
	if (soap_element_begin_in(soap, tag, 0))
		return NULL;
	if (*soap->type && soap_match_tag(soap, soap->type, type))
	{	soap->error = SOAP_TYPE;
		return NULL;
	}
	a = (struct SOAP_ENV__Detail *)soap_id_enter(soap, soap->id, a, SOAP_TYPE_SOAP_ENV__Detail, sizeof(struct SOAP_ENV__Detail), 0, NULL, NULL, NULL);
	if (!a)
		return NULL;
	soap_default_SOAP_ENV__Detail(soap, a);
	if (soap->body && !*soap->href)
	{
		for (;;)
		{	soap->error = SOAP_TAG_MISMATCH;
			if (soap_flag_fault && soap->error == SOAP_TAG_MISMATCH)
				if ((a->fault = soap_getelement(soap, &a->__type)))
				{	soap_flag_fault = 0;
					continue;
				}
			if (soap_flag___any && (soap->error == SOAP_TAG_MISMATCH || soap->error == SOAP_NO_TAG))
				if (soap_inliteral(soap, "-any", &a->__any))
				{	soap_flag___any--;
					continue;
				}
			if (soap->error == SOAP_TAG_MISMATCH)
				soap->error = soap_ignore_element(soap);
			if (soap->error == SOAP_NO_TAG)
				break;
			if (soap->error)
				return NULL;
		}
		if (soap_element_end_in(soap, tag))
			return NULL;
	}
	else
	{	a = (struct SOAP_ENV__Detail *)soap_id_forward(soap, soap->href, (void**)a, SOAP_TYPE_SOAP_ENV__Detail, 0, sizeof(struct SOAP_ENV__Detail), 0, NULL);
		if (soap->body && soap_element_end_in(soap, tag))
			return NULL;
	}
	return a;
}

#endif

#ifndef WITH_NOGLOBAL

SOAP_FMAC3 void SOAP_FMAC4 soap_serialize_SOAP_ENV__Code(struct soap *soap, const struct SOAP_ENV__Code *a)
{
	(void)soap; (void)a; /* appease -Wall -Werror */
	soap_serialize__QName(soap, &a->SOAP_ENV__Value);
	soap_serialize_PointerToSOAP_ENV__Code(soap, &a->SOAP_ENV__Subcode);
}

SOAP_FMAC3 void SOAP_FMAC4 soap_default_SOAP_ENV__Code(struct soap *soap, struct SOAP_ENV__Code *a)
{
	(void)soap; (void)a; /* appease -Wall -Werror */
	soap_default__QName(soap, &a->SOAP_ENV__Value);
	a->SOAP_ENV__Subcode = NULL;
}

SOAP_FMAC3 int SOAP_FMAC4 soap_put_SOAP_ENV__Code(struct soap *soap, const struct SOAP_ENV__Code *a, const char *tag, const char *type)
{
	register int id = soap_embed(soap, (void*)a, NULL, 0, tag, SOAP_TYPE_SOAP_ENV__Code);
	if (soap_out_SOAP_ENV__Code(soap, tag, id, a, type))
		return soap->error;
	return soap_putindependent(soap);
}

SOAP_FMAC3 int SOAP_FMAC4 soap_out_SOAP_ENV__Code(struct soap *soap, const char *tag, int id, const struct SOAP_ENV__Code *a, const char *type)
{
	const char *soap_tmp_SOAP_ENV__Value = soap_QName2s(soap, a->SOAP_ENV__Value);
	soap_element_begin_out(soap, tag, soap_embedded_id(soap, id, a, SOAP_TYPE_SOAP_ENV__Code), type);
	soap_out__QName(soap, "SOAP-ENV:Value", -1, (char*const*)&soap_tmp_SOAP_ENV__Value, "");
	soap_out_PointerToSOAP_ENV__Code(soap, "SOAP-ENV:Subcode", -1, &a->SOAP_ENV__Subcode, "");
	soap_element_end_out(soap, tag);
	return SOAP_OK;
}

SOAP_FMAC3 struct SOAP_ENV__Code * SOAP_FMAC4 soap_get_SOAP_ENV__Code(struct soap *soap, struct SOAP_ENV__Code *p, const char *tag, const char *type)
{
	if ((p = soap_in_SOAP_ENV__Code(soap, tag, p, type)))
		soap_getindependent(soap);
	return p;
}

SOAP_FMAC3 struct SOAP_ENV__Code * SOAP_FMAC4 soap_in_SOAP_ENV__Code(struct soap *soap, const char *tag, struct SOAP_ENV__Code *a, const char *type)
{
	short soap_flag_SOAP_ENV__Value = 1, soap_flag_SOAP_ENV__Subcode = 1;
	if (soap_element_begin_in(soap, tag, 0))
		return NULL;
	if (*soap->type && soap_match_tag(soap, soap->type, type))
	{	soap->error = SOAP_TYPE;
		return NULL;
	}
	a = (struct SOAP_ENV__Code *)soap_id_enter(soap, soap->id, a, SOAP_TYPE_SOAP_ENV__Code, sizeof(struct SOAP_ENV__Code), 0, NULL, NULL, NULL);
	if (!a)
		return NULL;
	soap_default_SOAP_ENV__Code(soap, a);
	if (soap->body && !*soap->href)
	{
		for (;;)
		{	soap->error = SOAP_TAG_MISMATCH;
			if (soap_flag_SOAP_ENV__Value && (soap->error == SOAP_TAG_MISMATCH || soap->error == SOAP_NO_TAG))
				if (soap_in__QName(soap, "SOAP-ENV:Value", &a->SOAP_ENV__Value, ""))
				{	soap_flag_SOAP_ENV__Value--;
					continue;
				}
			if (soap_flag_SOAP_ENV__Subcode && soap->error == SOAP_TAG_MISMATCH)
				if (soap_in_PointerToSOAP_ENV__Code(soap, "SOAP-ENV:Subcode", &a->SOAP_ENV__Subcode, ""))
				{	soap_flag_SOAP_ENV__Subcode--;
					continue;
				}
			if (soap->error == SOAP_TAG_MISMATCH)
				soap->error = soap_ignore_element(soap);
			if (soap->error == SOAP_NO_TAG)
				break;
			if (soap->error)
				return NULL;
		}
		if (soap_element_end_in(soap, tag))
			return NULL;
	}
	else
	{	a = (struct SOAP_ENV__Code *)soap_id_forward(soap, soap->href, (void**)a, SOAP_TYPE_SOAP_ENV__Code, 0, sizeof(struct SOAP_ENV__Code), 0, NULL);
		if (soap->body && soap_element_end_in(soap, tag))
			return NULL;
	}
	return a;
}

#endif

#ifndef WITH_NOGLOBAL

SOAP_FMAC3 void SOAP_FMAC4 soap_serialize_SOAP_ENV__Header(struct soap *soap, const struct SOAP_ENV__Header *a)
{
	(void)soap; (void)a; /* appease -Wall -Werror */
	/* transient dummy skipped */
}

SOAP_FMAC3 void SOAP_FMAC4 soap_default_SOAP_ENV__Header(struct soap *soap, struct SOAP_ENV__Header *a)
{
	(void)soap; (void)a; /* appease -Wall -Werror */
	/* transient dummy skipped */
}

SOAP_FMAC3 int SOAP_FMAC4 soap_put_SOAP_ENV__Header(struct soap *soap, const struct SOAP_ENV__Header *a, const char *tag, const char *type)
{
	register int id = soap_embed(soap, (void*)a, NULL, 0, tag, SOAP_TYPE_SOAP_ENV__Header);
	if (soap_out_SOAP_ENV__Header(soap, tag, id, a, type))
		return soap->error;
	return soap_putindependent(soap);
}

SOAP_FMAC3 int SOAP_FMAC4 soap_out_SOAP_ENV__Header(struct soap *soap, const char *tag, int id, const struct SOAP_ENV__Header *a, const char *type)
{
	soap_element_begin_out(soap, tag, soap_embedded_id(soap, id, a, SOAP_TYPE_SOAP_ENV__Header), type);
	/* transient dummy skipped */
	soap_element_end_out(soap, tag);
	return SOAP_OK;
}

SOAP_FMAC3 struct SOAP_ENV__Header * SOAP_FMAC4 soap_get_SOAP_ENV__Header(struct soap *soap, struct SOAP_ENV__Header *p, const char *tag, const char *type)
{
	if ((p = soap_in_SOAP_ENV__Header(soap, tag, p, type)))
		soap_getindependent(soap);
	return p;
}

SOAP_FMAC3 struct SOAP_ENV__Header * SOAP_FMAC4 soap_in_SOAP_ENV__Header(struct soap *soap, const char *tag, struct SOAP_ENV__Header *a, const char *type)
{;
	if (soap_element_begin_in(soap, tag, 0))
		return NULL;
	if (*soap->type && soap_match_tag(soap, soap->type, type))
	{	soap->error = SOAP_TYPE;
		return NULL;
	}
	a = (struct SOAP_ENV__Header *)soap_id_enter(soap, soap->id, a, SOAP_TYPE_SOAP_ENV__Header, sizeof(struct SOAP_ENV__Header), 0, NULL, NULL, NULL);
	if (!a)
		return NULL;
	soap_default_SOAP_ENV__Header(soap, a);
	if (soap->body && !*soap->href)
	{
		for (;;)
		{	soap->error = SOAP_TAG_MISMATCH;
		/* transient dummy skipped */
			if (soap->error == SOAP_TAG_MISMATCH)
				soap->error = soap_ignore_element(soap);
			if (soap->error == SOAP_NO_TAG)
				break;
			if (soap->error)
				return NULL;
		}
		if (soap_element_end_in(soap, tag))
			return NULL;
	}
	else
	{	a = (struct SOAP_ENV__Header *)soap_id_forward(soap, soap->href, (void**)a, SOAP_TYPE_SOAP_ENV__Header, 0, sizeof(struct SOAP_ENV__Header), 0, NULL);
		if (soap->body && soap_element_end_in(soap, tag))
			return NULL;
	}
	return a;
}

#endif

SOAP_FMAC3 void SOAP_FMAC4 soap_serialize_api__doSpellingSuggestion(struct soap *soap, const struct api__doSpellingSuggestion *a)
{
	(void)soap; (void)a; /* appease -Wall -Werror */
	soap_serialize_xsd__string(soap, &a->key);
	soap_serialize_xsd__string(soap, &a->phrase);
}

SOAP_FMAC3 void SOAP_FMAC4 soap_default_api__doSpellingSuggestion(struct soap *soap, struct api__doSpellingSuggestion *a)
{
	(void)soap; (void)a; /* appease -Wall -Werror */
	soap_default_xsd__string(soap, &a->key);
	soap_default_xsd__string(soap, &a->phrase);
}

SOAP_FMAC3 int SOAP_FMAC4 soap_put_api__doSpellingSuggestion(struct soap *soap, const struct api__doSpellingSuggestion *a, const char *tag, const char *type)
{
	register int id = soap_embed(soap, (void*)a, NULL, 0, tag, SOAP_TYPE_api__doSpellingSuggestion);
	if (soap_out_api__doSpellingSuggestion(soap, tag, id, a, type))
		return soap->error;
	return soap_putindependent(soap);
}

SOAP_FMAC3 int SOAP_FMAC4 soap_out_api__doSpellingSuggestion(struct soap *soap, const char *tag, int id, const struct api__doSpellingSuggestion *a, const char *type)
{
	soap_element_begin_out(soap, tag, soap_embedded_id(soap, id, a, SOAP_TYPE_api__doSpellingSuggestion), type);
	soap_out_xsd__string(soap, "key", -1, &a->key, "xsd:string");
	soap_out_xsd__string(soap, "phrase", -1, &a->phrase, "xsd:string");
	soap_element_end_out(soap, tag);
	return SOAP_OK;
}

SOAP_FMAC3 struct api__doSpellingSuggestion * SOAP_FMAC4 soap_get_api__doSpellingSuggestion(struct soap *soap, struct api__doSpellingSuggestion *p, const char *tag, const char *type)
{
	if ((p = soap_in_api__doSpellingSuggestion(soap, tag, p, type)))
		soap_getindependent(soap);
	return p;
}

SOAP_FMAC3 struct api__doSpellingSuggestion * SOAP_FMAC4 soap_in_api__doSpellingSuggestion(struct soap *soap, const char *tag, struct api__doSpellingSuggestion *a, const char *type)
{
	short soap_flag_key = 1, soap_flag_phrase = 1;
	if (soap_element_begin_in(soap, tag, 0))
		return NULL;
	if (*soap->type && soap_match_tag(soap, soap->type, type))
	{	soap->error = SOAP_TYPE;
		return NULL;
	}
	a = (struct api__doSpellingSuggestion *)soap_id_enter(soap, soap->id, a, SOAP_TYPE_api__doSpellingSuggestion, sizeof(struct api__doSpellingSuggestion), 0, NULL, NULL, NULL);
	if (!a)
		return NULL;
	soap_default_api__doSpellingSuggestion(soap, a);
	if (soap->body && !*soap->href)
	{
		for (;;)
		{	soap->error = SOAP_TAG_MISMATCH;
			if (soap_flag_key && (soap->error == SOAP_TAG_MISMATCH || soap->error == SOAP_NO_TAG))
				if (soap_in_xsd__string(soap, "key", &a->key, "xsd:string"))
				{	soap_flag_key--;
					continue;
				}
			if (soap_flag_phrase && (soap->error == SOAP_TAG_MISMATCH || soap->error == SOAP_NO_TAG))
				if (soap_in_xsd__string(soap, "phrase", &a->phrase, "xsd:string"))
				{	soap_flag_phrase--;
					continue;
				}
			if (soap->error == SOAP_TAG_MISMATCH)
				soap->error = soap_ignore_element(soap);
			if (soap->error == SOAP_NO_TAG)
				break;
			if (soap->error)
				return NULL;
		}
		if (soap_element_end_in(soap, tag))
			return NULL;
	}
	else
	{	a = (struct api__doSpellingSuggestion *)soap_id_forward(soap, soap->href, (void**)a, SOAP_TYPE_api__doSpellingSuggestion, 0, sizeof(struct api__doSpellingSuggestion), 0, NULL);
		if (soap->body && soap_element_end_in(soap, tag))
			return NULL;
	}
	return a;
}

SOAP_FMAC3 void SOAP_FMAC4 soap_serialize_api__doSpellingSuggestionResponse(struct soap *soap, const struct api__doSpellingSuggestionResponse *a)
{
	(void)soap; (void)a; /* appease -Wall -Werror */
	soap_serialize_PointerToxsd__string(soap, &a->_return);
}

SOAP_FMAC3 void SOAP_FMAC4 soap_default_api__doSpellingSuggestionResponse(struct soap *soap, struct api__doSpellingSuggestionResponse *a)
{
	(void)soap; (void)a; /* appease -Wall -Werror */
	a->_return = NULL;
}

SOAP_FMAC3 int SOAP_FMAC4 soap_put_api__doSpellingSuggestionResponse(struct soap *soap, const struct api__doSpellingSuggestionResponse *a, const char *tag, const char *type)
{
	register int id = soap_embed(soap, (void*)a, NULL, 0, tag, SOAP_TYPE_api__doSpellingSuggestionResponse);
	if (soap_out_api__doSpellingSuggestionResponse(soap, tag, id, a, type))
		return soap->error;
	return soap_putindependent(soap);
}

SOAP_FMAC3 int SOAP_FMAC4 soap_out_api__doSpellingSuggestionResponse(struct soap *soap, const char *tag, int id, const struct api__doSpellingSuggestionResponse *a, const char *type)
{
	soap_element_begin_out(soap, tag, soap_embedded_id(soap, id, a, SOAP_TYPE_api__doSpellingSuggestionResponse), type);
	if (a->_return)
		soap_element_result(soap, "return");
	soap_out_PointerToxsd__string(soap, "return", -1, &a->_return, "");
	soap_element_end_out(soap, tag);
	return SOAP_OK;
}

SOAP_FMAC3 struct api__doSpellingSuggestionResponse * SOAP_FMAC4 soap_get_api__doSpellingSuggestionResponse(struct soap *soap, struct api__doSpellingSuggestionResponse *p, const char *tag, const char *type)
{
	if ((p = soap_in_api__doSpellingSuggestionResponse(soap, tag, p, type)))
		soap_getindependent(soap);
	return p;
}

SOAP_FMAC3 struct api__doSpellingSuggestionResponse * SOAP_FMAC4 soap_in_api__doSpellingSuggestionResponse(struct soap *soap, const char *tag, struct api__doSpellingSuggestionResponse *a, const char *type)
{
	short soap_flag__return = 1;
	if (soap_element_begin_in(soap, tag, 0))
		return NULL;
	if (*soap->type && soap_match_tag(soap, soap->type, type))
	{	soap->error = SOAP_TYPE;
		return NULL;
	}
	a = (struct api__doSpellingSuggestionResponse *)soap_id_enter(soap, soap->id, a, SOAP_TYPE_api__doSpellingSuggestionResponse, sizeof(struct api__doSpellingSuggestionResponse), 0, NULL, NULL, NULL);
	if (!a)
		return NULL;
	soap_default_api__doSpellingSuggestionResponse(soap, a);
	if (soap->body && !*soap->href)
	{
		for (;;)
		{	soap->error = SOAP_TAG_MISMATCH;
			if (soap_flag__return && soap->error == SOAP_TAG_MISMATCH)
				if (soap_in_PointerToxsd__string(soap, NULL, &a->_return, "xsd:string"))
				{	soap_flag__return--;
					continue;
				}
			if (soap->error == SOAP_TAG_MISMATCH)
				soap->error = soap_ignore_element(soap);
			if (soap->error == SOAP_NO_TAG)
				break;
			if (soap->error)
				return NULL;
		}
		if (soap_element_end_in(soap, tag))
			return NULL;
	}
	else
	{	a = (struct api__doSpellingSuggestionResponse *)soap_id_forward(soap, soap->href, (void**)a, SOAP_TYPE_api__doSpellingSuggestionResponse, 0, sizeof(struct api__doSpellingSuggestionResponse), 0, NULL);
		if (soap->body && soap_element_end_in(soap, tag))
			return NULL;
	}
	return a;
}

SOAP_FMAC3 void SOAP_FMAC4 soap_serialize_api__doGetCachedPage(struct soap *soap, const struct api__doGetCachedPage *a)
{
	(void)soap; (void)a; /* appease -Wall -Werror */
	soap_serialize_xsd__string(soap, &a->key);
	soap_serialize_xsd__string(soap, &a->url);
}

SOAP_FMAC3 void SOAP_FMAC4 soap_default_api__doGetCachedPage(struct soap *soap, struct api__doGetCachedPage *a)
{
	(void)soap; (void)a; /* appease -Wall -Werror */
	soap_default_xsd__string(soap, &a->key);
	soap_default_xsd__string(soap, &a->url);
}

SOAP_FMAC3 int SOAP_FMAC4 soap_put_api__doGetCachedPage(struct soap *soap, const struct api__doGetCachedPage *a, const char *tag, const char *type)
{
	register int id = soap_embed(soap, (void*)a, NULL, 0, tag, SOAP_TYPE_api__doGetCachedPage);
	if (soap_out_api__doGetCachedPage(soap, tag, id, a, type))
		return soap->error;
	return soap_putindependent(soap);
}

SOAP_FMAC3 int SOAP_FMAC4 soap_out_api__doGetCachedPage(struct soap *soap, const char *tag, int id, const struct api__doGetCachedPage *a, const char *type)
{
	soap_element_begin_out(soap, tag, soap_embedded_id(soap, id, a, SOAP_TYPE_api__doGetCachedPage), type);
	soap_out_xsd__string(soap, "key", -1, &a->key, "xsd:string");
	soap_out_xsd__string(soap, "url", -1, &a->url, "xsd:string");
	soap_element_end_out(soap, tag);
	return SOAP_OK;
}

SOAP_FMAC3 struct api__doGetCachedPage * SOAP_FMAC4 soap_get_api__doGetCachedPage(struct soap *soap, struct api__doGetCachedPage *p, const char *tag, const char *type)
{
	if ((p = soap_in_api__doGetCachedPage(soap, tag, p, type)))
		soap_getindependent(soap);
	return p;
}

SOAP_FMAC3 struct api__doGetCachedPage * SOAP_FMAC4 soap_in_api__doGetCachedPage(struct soap *soap, const char *tag, struct api__doGetCachedPage *a, const char *type)
{
	short soap_flag_key = 1, soap_flag_url = 1;
	if (soap_element_begin_in(soap, tag, 0))
		return NULL;
	if (*soap->type && soap_match_tag(soap, soap->type, type))
	{	soap->error = SOAP_TYPE;
		return NULL;
	}
	a = (struct api__doGetCachedPage *)soap_id_enter(soap, soap->id, a, SOAP_TYPE_api__doGetCachedPage, sizeof(struct api__doGetCachedPage), 0, NULL, NULL, NULL);
	if (!a)
		return NULL;
	soap_default_api__doGetCachedPage(soap, a);
	if (soap->body && !*soap->href)
	{
		for (;;)
		{	soap->error = SOAP_TAG_MISMATCH;
			if (soap_flag_key && (soap->error == SOAP_TAG_MISMATCH || soap->error == SOAP_NO_TAG))
				if (soap_in_xsd__string(soap, "key", &a->key, "xsd:string"))
				{	soap_flag_key--;
					continue;
				}
			if (soap_flag_url && (soap->error == SOAP_TAG_MISMATCH || soap->error == SOAP_NO_TAG))
				if (soap_in_xsd__string(soap, "url", &a->url, "xsd:string"))
				{	soap_flag_url--;
					continue;
				}
			if (soap->error == SOAP_TAG_MISMATCH)
				soap->error = soap_ignore_element(soap);
			if (soap->error == SOAP_NO_TAG)
				break;
			if (soap->error)
				return NULL;
		}
		if (soap_element_end_in(soap, tag))
			return NULL;
	}
	else
	{	a = (struct api__doGetCachedPage *)soap_id_forward(soap, soap->href, (void**)a, SOAP_TYPE_api__doGetCachedPage, 0, sizeof(struct api__doGetCachedPage), 0, NULL);
		if (soap->body && soap_element_end_in(soap, tag))
			return NULL;
	}
	return a;
}

SOAP_FMAC3 void SOAP_FMAC4 soap_serialize_api__doGetCachedPageResponse(struct soap *soap, const struct api__doGetCachedPageResponse *a)
{
	(void)soap; (void)a; /* appease -Wall -Werror */
	soap_serialize_PointerToxsd__base64Binary(soap, &a->_return);
}

SOAP_FMAC3 void SOAP_FMAC4 soap_default_api__doGetCachedPageResponse(struct soap *soap, struct api__doGetCachedPageResponse *a)
{
	(void)soap; (void)a; /* appease -Wall -Werror */
	a->_return = NULL;
}

SOAP_FMAC3 int SOAP_FMAC4 soap_put_api__doGetCachedPageResponse(struct soap *soap, const struct api__doGetCachedPageResponse *a, const char *tag, const char *type)
{
	register int id = soap_embed(soap, (void*)a, NULL, 0, tag, SOAP_TYPE_api__doGetCachedPageResponse);
	if (soap_out_api__doGetCachedPageResponse(soap, tag, id, a, type))
		return soap->error;
	return soap_putindependent(soap);
}

SOAP_FMAC3 int SOAP_FMAC4 soap_out_api__doGetCachedPageResponse(struct soap *soap, const char *tag, int id, const struct api__doGetCachedPageResponse *a, const char *type)
{
	soap_element_begin_out(soap, tag, soap_embedded_id(soap, id, a, SOAP_TYPE_api__doGetCachedPageResponse), type);
	if (a->_return)
		soap_element_result(soap, "return");
	soap_out_PointerToxsd__base64Binary(soap, "return", -1, &a->_return, "");
	soap_element_end_out(soap, tag);
	return SOAP_OK;
}

SOAP_FMAC3 struct api__doGetCachedPageResponse * SOAP_FMAC4 soap_get_api__doGetCachedPageResponse(struct soap *soap, struct api__doGetCachedPageResponse *p, const char *tag, const char *type)
{
	if ((p = soap_in_api__doGetCachedPageResponse(soap, tag, p, type)))
		soap_getindependent(soap);
	return p;
}

SOAP_FMAC3 struct api__doGetCachedPageResponse * SOAP_FMAC4 soap_in_api__doGetCachedPageResponse(struct soap *soap, const char *tag, struct api__doGetCachedPageResponse *a, const char *type)
{
	short soap_flag__return = 1;
	if (soap_element_begin_in(soap, tag, 0))
		return NULL;
	if (*soap->type && soap_match_tag(soap, soap->type, type))
	{	soap->error = SOAP_TYPE;
		return NULL;
	}
	a = (struct api__doGetCachedPageResponse *)soap_id_enter(soap, soap->id, a, SOAP_TYPE_api__doGetCachedPageResponse, sizeof(struct api__doGetCachedPageResponse), 0, NULL, NULL, NULL);
	if (!a)
		return NULL;
	soap_default_api__doGetCachedPageResponse(soap, a);
	if (soap->body && !*soap->href)
	{
		for (;;)
		{	soap->error = SOAP_TAG_MISMATCH;
			if (soap_flag__return && soap->error == SOAP_TAG_MISMATCH)
				if (soap_in_PointerToxsd__base64Binary(soap, NULL, &a->_return, "xsd:base64Binary"))
				{	soap_flag__return--;
					continue;
				}
			if (soap->error == SOAP_TAG_MISMATCH)
				soap->error = soap_ignore_element(soap);
			if (soap->error == SOAP_NO_TAG)
				break;
			if (soap->error)
				return NULL;
		}
		if (soap_element_end_in(soap, tag))
			return NULL;
	}
	else
	{	a = (struct api__doGetCachedPageResponse *)soap_id_forward(soap, soap->href, (void**)a, SOAP_TYPE_api__doGetCachedPageResponse, 0, sizeof(struct api__doGetCachedPageResponse), 0, NULL);
		if (soap->body && soap_element_end_in(soap, tag))
			return NULL;
	}
	return a;
}

SOAP_FMAC3 void SOAP_FMAC4 soap_serialize_api__doGoogleSearch(struct soap *soap, const struct api__doGoogleSearch *a)
{
	(void)soap; (void)a; /* appease -Wall -Werror */
	soap_serialize_xsd__string(soap, &a->key);
	soap_serialize_xsd__string(soap, &a->q);
	soap_serialize_xsd__string(soap, &a->restrict_);
	soap_serialize_xsd__string(soap, &a->lr);
	soap_serialize_xsd__string(soap, &a->ie);
	soap_serialize_xsd__string(soap, &a->oe);
}

SOAP_FMAC3 void SOAP_FMAC4 soap_default_api__doGoogleSearch(struct soap *soap, struct api__doGoogleSearch *a)
{
	(void)soap; (void)a; /* appease -Wall -Werror */
	soap_default_xsd__string(soap, &a->key);
	soap_default_xsd__string(soap, &a->q);
	soap_default_xsd__int(soap, &a->start);
	soap_default_xsd__int(soap, &a->maxResults);
	soap_default_xsd__boolean(soap, &a->filter);
	soap_default_xsd__string(soap, &a->restrict_);
	soap_default_xsd__boolean(soap, &a->safeSearch);
	soap_default_xsd__string(soap, &a->lr);
	soap_default_xsd__string(soap, &a->ie);
	soap_default_xsd__string(soap, &a->oe);
}

SOAP_FMAC3 int SOAP_FMAC4 soap_put_api__doGoogleSearch(struct soap *soap, const struct api__doGoogleSearch *a, const char *tag, const char *type)
{
	register int id = soap_embed(soap, (void*)a, NULL, 0, tag, SOAP_TYPE_api__doGoogleSearch);
	if (soap_out_api__doGoogleSearch(soap, tag, id, a, type))
		return soap->error;
	return soap_putindependent(soap);
}

SOAP_FMAC3 int SOAP_FMAC4 soap_out_api__doGoogleSearch(struct soap *soap, const char *tag, int id, const struct api__doGoogleSearch *a, const char *type)
{
	soap_element_begin_out(soap, tag, soap_embedded_id(soap, id, a, SOAP_TYPE_api__doGoogleSearch), type);
	soap_out_xsd__string(soap, "key", -1, &a->key, "xsd:string");
	soap_out_xsd__string(soap, "q", -1, &a->q, "xsd:string");
	soap_out_xsd__int(soap, "start", -1, &a->start, "xsd:int");
	soap_out_xsd__int(soap, "maxResults", -1, &a->maxResults, "xsd:int");
	soap_out_xsd__boolean(soap, "filter", -1, &a->filter, "xsd:boolean");
	soap_out_xsd__string(soap, "restrict", -1, &a->restrict_, "xsd:string");
	soap_out_xsd__boolean(soap, "safeSearch", -1, &a->safeSearch, "xsd:boolean");
	soap_out_xsd__string(soap, "lr", -1, &a->lr, "xsd:string");
	soap_out_xsd__string(soap, "ie", -1, &a->ie, "xsd:string");
	soap_out_xsd__string(soap, "oe", -1, &a->oe, "xsd:string");
	soap_element_end_out(soap, tag);
	return SOAP_OK;
}

SOAP_FMAC3 struct api__doGoogleSearch * SOAP_FMAC4 soap_get_api__doGoogleSearch(struct soap *soap, struct api__doGoogleSearch *p, const char *tag, const char *type)
{
	if ((p = soap_in_api__doGoogleSearch(soap, tag, p, type)))
		soap_getindependent(soap);
	return p;
}

SOAP_FMAC3 struct api__doGoogleSearch * SOAP_FMAC4 soap_in_api__doGoogleSearch(struct soap *soap, const char *tag, struct api__doGoogleSearch *a, const char *type)
{
	short soap_flag_key = 1, soap_flag_q = 1, soap_flag_start = 1, soap_flag_maxResults = 1, soap_flag_filter = 1, soap_flag_restrict_ = 1, soap_flag_safeSearch = 1, soap_flag_lr = 1, soap_flag_ie = 1, soap_flag_oe = 1;
	if (soap_element_begin_in(soap, tag, 0))
		return NULL;
	if (*soap->type && soap_match_tag(soap, soap->type, type))
	{	soap->error = SOAP_TYPE;
		return NULL;
	}
	a = (struct api__doGoogleSearch *)soap_id_enter(soap, soap->id, a, SOAP_TYPE_api__doGoogleSearch, sizeof(struct api__doGoogleSearch), 0, NULL, NULL, NULL);
	if (!a)
		return NULL;
	soap_default_api__doGoogleSearch(soap, a);
	if (soap->body && !*soap->href)
	{
		for (;;)
		{	soap->error = SOAP_TAG_MISMATCH;
			if (soap_flag_key && (soap->error == SOAP_TAG_MISMATCH || soap->error == SOAP_NO_TAG))
				if (soap_in_xsd__string(soap, "key", &a->key, "xsd:string"))
				{	soap_flag_key--;
					continue;
				}
			if (soap_flag_q && (soap->error == SOAP_TAG_MISMATCH || soap->error == SOAP_NO_TAG))
				if (soap_in_xsd__string(soap, "q", &a->q, "xsd:string"))
				{	soap_flag_q--;
					continue;
				}
			if (soap_flag_start && soap->error == SOAP_TAG_MISMATCH)
				if (soap_in_xsd__int(soap, "start", &a->start, "xsd:int"))
				{	soap_flag_start--;
					continue;
				}
			if (soap_flag_maxResults && soap->error == SOAP_TAG_MISMATCH)
				if (soap_in_xsd__int(soap, "maxResults", &a->maxResults, "xsd:int"))
				{	soap_flag_maxResults--;
					continue;
				}
			if (soap_flag_filter && soap->error == SOAP_TAG_MISMATCH)
				if (soap_in_xsd__boolean(soap, "filter", &a->filter, "xsd:boolean"))
				{	soap_flag_filter--;
					continue;
				}
			if (soap_flag_restrict_ && (soap->error == SOAP_TAG_MISMATCH || soap->error == SOAP_NO_TAG))
				if (soap_in_xsd__string(soap, "restrict", &a->restrict_, "xsd:string"))
				{	soap_flag_restrict_--;
					continue;
				}
			if (soap_flag_safeSearch && soap->error == SOAP_TAG_MISMATCH)
				if (soap_in_xsd__boolean(soap, "safeSearch", &a->safeSearch, "xsd:boolean"))
				{	soap_flag_safeSearch--;
					continue;
				}
			if (soap_flag_lr && (soap->error == SOAP_TAG_MISMATCH || soap->error == SOAP_NO_TAG))
				if (soap_in_xsd__string(soap, "lr", &a->lr, "xsd:string"))
				{	soap_flag_lr--;
					continue;
				}
			if (soap_flag_ie && (soap->error == SOAP_TAG_MISMATCH || soap->error == SOAP_NO_TAG))
				if (soap_in_xsd__string(soap, "ie", &a->ie, "xsd:string"))
				{	soap_flag_ie--;
					continue;
				}
			if (soap_flag_oe && (soap->error == SOAP_TAG_MISMATCH || soap->error == SOAP_NO_TAG))
				if (soap_in_xsd__string(soap, "oe", &a->oe, "xsd:string"))
				{	soap_flag_oe--;
					continue;
				}
			if (soap->error == SOAP_TAG_MISMATCH)
				soap->error = soap_ignore_element(soap);
			if (soap->error == SOAP_NO_TAG)
				break;
			if (soap->error)
				return NULL;
		}
		if ((soap->mode & SOAP_XML_STRICT) && (soap_flag_start > 0 || soap_flag_maxResults > 0 || soap_flag_filter > 0 || soap_flag_safeSearch > 0))
		{	soap->error = SOAP_OCCURS;
			return NULL;
		}
		if (soap_element_end_in(soap, tag))
			return NULL;
	}
	else
	{	a = (struct api__doGoogleSearch *)soap_id_forward(soap, soap->href, (void**)a, SOAP_TYPE_api__doGoogleSearch, 0, sizeof(struct api__doGoogleSearch), 0, NULL);
		if (soap->body && soap_element_end_in(soap, tag))
			return NULL;
	}
	return a;
}

SOAP_FMAC3 void SOAP_FMAC4 soap_serialize_api__doGoogleSearchResponse(struct soap *soap, const struct api__doGoogleSearchResponse *a)
{
	(void)soap; (void)a; /* appease -Wall -Werror */
	soap_serialize_api__GoogleSearchResult(soap, &a->_return);
}

SOAP_FMAC3 void SOAP_FMAC4 soap_default_api__doGoogleSearchResponse(struct soap *soap, struct api__doGoogleSearchResponse *a)
{
	(void)soap; (void)a; /* appease -Wall -Werror */
	soap_default_api__GoogleSearchResult(soap, &a->_return);
}

SOAP_FMAC3 int SOAP_FMAC4 soap_put_api__doGoogleSearchResponse(struct soap *soap, const struct api__doGoogleSearchResponse *a, const char *tag, const char *type)
{
	register int id = soap_embed(soap, (void*)a, NULL, 0, tag, SOAP_TYPE_api__doGoogleSearchResponse);
	if (soap_out_api__doGoogleSearchResponse(soap, tag, id, a, type))
		return soap->error;
	return soap_putindependent(soap);
}

SOAP_FMAC3 int SOAP_FMAC4 soap_out_api__doGoogleSearchResponse(struct soap *soap, const char *tag, int id, const struct api__doGoogleSearchResponse *a, const char *type)
{
	soap_element_begin_out(soap, tag, soap_embedded_id(soap, id, a, SOAP_TYPE_api__doGoogleSearchResponse), type);
	soap_element_result(soap, "return");
	soap_out_api__GoogleSearchResult(soap, "return", -1, &a->_return, "");
	soap_element_end_out(soap, tag);
	return SOAP_OK;
}

SOAP_FMAC3 struct api__doGoogleSearchResponse * SOAP_FMAC4 soap_get_api__doGoogleSearchResponse(struct soap *soap, struct api__doGoogleSearchResponse *p, const char *tag, const char *type)
{
	if ((p = soap_in_api__doGoogleSearchResponse(soap, tag, p, type)))
		soap_getindependent(soap);
	return p;
}

SOAP_FMAC3 struct api__doGoogleSearchResponse * SOAP_FMAC4 soap_in_api__doGoogleSearchResponse(struct soap *soap, const char *tag, struct api__doGoogleSearchResponse *a, const char *type)
{
	short soap_flag__return = 1;
	if (soap_element_begin_in(soap, tag, 0))
		return NULL;
	if (*soap->type && soap_match_tag(soap, soap->type, type))
	{	soap->error = SOAP_TYPE;
		return NULL;
	}
	a = (struct api__doGoogleSearchResponse *)soap_id_enter(soap, soap->id, a, SOAP_TYPE_api__doGoogleSearchResponse, sizeof(struct api__doGoogleSearchResponse), 0, NULL, NULL, NULL);
	if (!a)
		return NULL;
	soap_default_api__doGoogleSearchResponse(soap, a);
	if (soap->body && !*soap->href)
	{
		for (;;)
		{	soap->error = SOAP_TAG_MISMATCH;
			if (soap_flag__return && soap->error == SOAP_TAG_MISMATCH)
				if (soap_in_api__GoogleSearchResult(soap, NULL, &a->_return, "api:GoogleSearchResult"))
				{	soap_flag__return--;
					continue;
				}
			if (soap->error == SOAP_TAG_MISMATCH)
				soap->error = soap_ignore_element(soap);
			if (soap->error == SOAP_NO_TAG)
				break;
			if (soap->error)
				return NULL;
		}
		if ((soap->mode & SOAP_XML_STRICT) && (soap_flag__return > 0))
		{	soap->error = SOAP_OCCURS;
			return NULL;
		}
		if (soap_element_end_in(soap, tag))
			return NULL;
	}
	else
	{	a = (struct api__doGoogleSearchResponse *)soap_id_forward(soap, soap->href, (void**)a, SOAP_TYPE_api__doGoogleSearchResponse, 0, sizeof(struct api__doGoogleSearchResponse), 0, NULL);
		if (soap->body && soap_element_end_in(soap, tag))
			return NULL;
	}
	return a;
}

SOAP_FMAC3 void SOAP_FMAC4 soap_serialize_api__GoogleSearchResult(struct soap *soap, const struct api__GoogleSearchResult *a)
{
	(void)soap; (void)a; /* appease -Wall -Werror */
	soap_serialize_xsd__string(soap, &a->searchComments);
	soap_serialize_ResultElementArray(soap, &a->resultElements);
	soap_serialize_xsd__string(soap, &a->searchQuery);
	soap_serialize_xsd__string(soap, &a->searchTips);
	soap_serialize_DirectoryCategoryArray(soap, &a->directoryCategories);
}

SOAP_FMAC3 void SOAP_FMAC4 soap_default_api__GoogleSearchResult(struct soap *soap, struct api__GoogleSearchResult *a)
{
	(void)soap; (void)a; /* appease -Wall -Werror */
	soap_default_xsd__boolean(soap, &a->documentFiltering);
	soap_default_xsd__string(soap, &a->searchComments);
	soap_default_xsd__int(soap, &a->estimatedTotalResultsCount);
	soap_default_xsd__boolean(soap, &a->estimateIsExact);
	soap_default_ResultElementArray(soap, &a->resultElements);
	soap_default_xsd__string(soap, &a->searchQuery);
	soap_default_xsd__int(soap, &a->startIndex);
	soap_default_xsd__int(soap, &a->endIndex);
	soap_default_xsd__string(soap, &a->searchTips);
	soap_default_DirectoryCategoryArray(soap, &a->directoryCategories);
	soap_default_xsd__double(soap, &a->searchTime);
}

SOAP_FMAC3 int SOAP_FMAC4 soap_put_api__GoogleSearchResult(struct soap *soap, const struct api__GoogleSearchResult *a, const char *tag, const char *type)
{
	register int id = soap_embed(soap, (void*)a, NULL, 0, tag, SOAP_TYPE_api__GoogleSearchResult);
	if (soap_out_api__GoogleSearchResult(soap, tag, id, a, type))
		return soap->error;
	return soap_putindependent(soap);
}

SOAP_FMAC3 int SOAP_FMAC4 soap_out_api__GoogleSearchResult(struct soap *soap, const char *tag, int id, const struct api__GoogleSearchResult *a, const char *type)
{
	soap_element_begin_out(soap, tag, soap_embedded_id(soap, id, a, SOAP_TYPE_api__GoogleSearchResult), type);
	soap_out_xsd__boolean(soap, "documentFiltering", -1, &a->documentFiltering, "");
	soap_out_xsd__string(soap, "searchComments", -1, &a->searchComments, "");
	soap_out_xsd__int(soap, "estimatedTotalResultsCount", -1, &a->estimatedTotalResultsCount, "");
	soap_out_xsd__boolean(soap, "estimateIsExact", -1, &a->estimateIsExact, "");
	soap_out_ResultElementArray(soap, "resultElements", -1, &a->resultElements, "");
	soap_out_xsd__string(soap, "searchQuery", -1, &a->searchQuery, "");
	soap_out_xsd__int(soap, "startIndex", -1, &a->startIndex, "");
	soap_out_xsd__int(soap, "endIndex", -1, &a->endIndex, "");
	soap_out_xsd__string(soap, "searchTips", -1, &a->searchTips, "");
	soap_out_DirectoryCategoryArray(soap, "directoryCategories", -1, &a->directoryCategories, "");
	soap_out_xsd__double(soap, "searchTime", -1, &a->searchTime, "");
	soap_element_end_out(soap, tag);
	return SOAP_OK;
}

SOAP_FMAC3 struct api__GoogleSearchResult * SOAP_FMAC4 soap_get_api__GoogleSearchResult(struct soap *soap, struct api__GoogleSearchResult *p, const char *tag, const char *type)
{
	if ((p = soap_in_api__GoogleSearchResult(soap, tag, p, type)))
		soap_getindependent(soap);
	return p;
}

SOAP_FMAC3 struct api__GoogleSearchResult * SOAP_FMAC4 soap_in_api__GoogleSearchResult(struct soap *soap, const char *tag, struct api__GoogleSearchResult *a, const char *type)
{
	short soap_flag_documentFiltering = 1, soap_flag_searchComments = 1, soap_flag_estimatedTotalResultsCount = 1, soap_flag_estimateIsExact = 1, soap_flag_resultElements = 1, soap_flag_searchQuery = 1, soap_flag_startIndex = 1, soap_flag_endIndex = 1, soap_flag_searchTips = 1, soap_flag_directoryCategories = 1, soap_flag_searchTime = 1;
	if (soap_element_begin_in(soap, tag, 0))
		return NULL;
	if (*soap->type && soap_match_tag(soap, soap->type, type))
	{	soap->error = SOAP_TYPE;
		return NULL;
	}
	a = (struct api__GoogleSearchResult *)soap_id_enter(soap, soap->id, a, SOAP_TYPE_api__GoogleSearchResult, sizeof(struct api__GoogleSearchResult), 0, NULL, NULL, NULL);
	if (!a)
		return NULL;
	soap_default_api__GoogleSearchResult(soap, a);
	if (soap->body && !*soap->href)
	{
		for (;;)
		{	soap->error = SOAP_TAG_MISMATCH;
			if (soap_flag_documentFiltering && soap->error == SOAP_TAG_MISMATCH)
				if (soap_in_xsd__boolean(soap, "documentFiltering", &a->documentFiltering, "xsd:boolean"))
				{	soap_flag_documentFiltering--;
					continue;
				}
			if (soap_flag_searchComments && (soap->error == SOAP_TAG_MISMATCH || soap->error == SOAP_NO_TAG))
				if (soap_in_xsd__string(soap, "searchComments", &a->searchComments, "xsd:string"))
				{	soap_flag_searchComments--;
					continue;
				}
			if (soap_flag_estimatedTotalResultsCount && soap->error == SOAP_TAG_MISMATCH)
				if (soap_in_xsd__int(soap, "estimatedTotalResultsCount", &a->estimatedTotalResultsCount, "xsd:int"))
				{	soap_flag_estimatedTotalResultsCount--;
					continue;
				}
			if (soap_flag_estimateIsExact && soap->error == SOAP_TAG_MISMATCH)
				if (soap_in_xsd__boolean(soap, "estimateIsExact", &a->estimateIsExact, "xsd:boolean"))
				{	soap_flag_estimateIsExact--;
					continue;
				}
			if (soap_flag_resultElements && soap->error == SOAP_TAG_MISMATCH)
				if (soap_in_ResultElementArray(soap, "resultElements", &a->resultElements, "api:ResultElement"))
				{	soap_flag_resultElements--;
					continue;
				}
			if (soap_flag_searchQuery && (soap->error == SOAP_TAG_MISMATCH || soap->error == SOAP_NO_TAG))
				if (soap_in_xsd__string(soap, "searchQuery", &a->searchQuery, "xsd:string"))
				{	soap_flag_searchQuery--;
					continue;
				}
			if (soap_flag_startIndex && soap->error == SOAP_TAG_MISMATCH)
				if (soap_in_xsd__int(soap, "startIndex", &a->startIndex, "xsd:int"))
				{	soap_flag_startIndex--;
					continue;
				}
			if (soap_flag_endIndex && soap->error == SOAP_TAG_MISMATCH)
				if (soap_in_xsd__int(soap, "endIndex", &a->endIndex, "xsd:int"))
				{	soap_flag_endIndex--;
					continue;
				}
			if (soap_flag_searchTips && (soap->error == SOAP_TAG_MISMATCH || soap->error == SOAP_NO_TAG))
				if (soap_in_xsd__string(soap, "searchTips", &a->searchTips, "xsd:string"))
				{	soap_flag_searchTips--;
					continue;
				}
			if (soap_flag_directoryCategories && soap->error == SOAP_TAG_MISMATCH)
				if (soap_in_DirectoryCategoryArray(soap, "directoryCategories", &a->directoryCategories, "api:DirectoryCategory"))
				{	soap_flag_directoryCategories--;
					continue;
				}
			if (soap_flag_searchTime && soap->error == SOAP_TAG_MISMATCH)
				if (soap_in_xsd__double(soap, "searchTime", &a->searchTime, "xsd:double"))
				{	soap_flag_searchTime--;
					continue;
				}
			if (soap->error == SOAP_TAG_MISMATCH)
				soap->error = soap_ignore_element(soap);
			if (soap->error == SOAP_NO_TAG)
				break;
			if (soap->error)
				return NULL;
		}
		if ((soap->mode & SOAP_XML_STRICT) && (soap_flag_documentFiltering > 0 || soap_flag_estimatedTotalResultsCount > 0 || soap_flag_estimateIsExact > 0 || soap_flag_resultElements > 0 || soap_flag_startIndex > 0 || soap_flag_endIndex > 0 || soap_flag_directoryCategories > 0 || soap_flag_searchTime > 0))
		{	soap->error = SOAP_OCCURS;
			return NULL;
		}
		if (soap_element_end_in(soap, tag))
			return NULL;
	}
	else
	{	a = (struct api__GoogleSearchResult *)soap_id_forward(soap, soap->href, (void**)a, SOAP_TYPE_api__GoogleSearchResult, 0, sizeof(struct api__GoogleSearchResult), 0, NULL);
		if (soap->body && soap_element_end_in(soap, tag))
			return NULL;
	}
	return a;
}

SOAP_FMAC3 void SOAP_FMAC4 soap_serialize_ResultElementArray(struct soap *soap, struct ResultElementArray const*a)
{
	int i;
	if (a->__ptr && !soap_array_reference(soap, a, (struct soap_array*)&a->__ptr, 1, SOAP_TYPE_ResultElementArray))
		for (i = 0; i < a->__size; i++)
		{	soap_embedded(soap, a->__ptr + i, SOAP_TYPE_api__ResultElement);
			soap_serialize_api__ResultElement(soap, a->__ptr + i);
		}
}

SOAP_FMAC3 void SOAP_FMAC4 soap_default_ResultElementArray(struct soap *soap, struct ResultElementArray *a)
{
	a->__size = 0;
	a->__ptr = NULL;
}

SOAP_FMAC3 int SOAP_FMAC4 soap_put_ResultElementArray(struct soap *soap, const struct ResultElementArray *a, const char *tag, const char *type)
{
	register int id = soap_embed(soap, (void*)a, (struct soap_array*)&a->__ptr, 1, tag, SOAP_TYPE_ResultElementArray);
	if (soap_out_ResultElementArray(soap, tag, id, a, type))
		return soap->error;
	return soap_putindependent(soap);
}

SOAP_FMAC3 int SOAP_FMAC4 soap_out_ResultElementArray(struct soap *soap, const char *tag, int id, const struct ResultElementArray *a, const char *type)
{
	int i, n = a->__size;
	char *t = soap_putsize(soap, "api:ResultElement", a->__size);
	id = soap_element_id(soap, tag, id, a, (struct soap_array*)&a->__ptr, 1, type, SOAP_TYPE_ResultElementArray);
	if (id < 0)
		return soap->error;
	soap_array_begin_out(soap, tag, id, t, NULL);
	for (i = 0; i < n; i++)
	{
		soap->position = 1;
		soap->positions[0] = i;
		soap_out_api__ResultElement(soap, "item", -1, &a->__ptr[i], "");
	}
	soap->position = 0;
	soap_element_end_out(soap, tag);
	return SOAP_OK;
}

SOAP_FMAC3 struct ResultElementArray * SOAP_FMAC4 soap_get_ResultElementArray(struct soap *soap, struct ResultElementArray *p, const char *tag, const char *type)
{
	if ((p = soap_in_ResultElementArray(soap, tag, p, type)))
		soap_getindependent(soap);
	return p;
}

SOAP_FMAC3 struct ResultElementArray * SOAP_FMAC4 soap_in_ResultElementArray(struct soap *soap, const char *tag, struct ResultElementArray *a, const char *type)
{	int i, j;
	struct api__ResultElement *p;
	if (soap_element_begin_in(soap, tag, 1))
		return NULL;
	if (soap_match_array(soap, type))
	{	soap->error = SOAP_TYPE;
		return NULL;
	}
	a = (struct ResultElementArray *)soap_id_enter(soap, soap->id, a, SOAP_TYPE_ResultElementArray, sizeof(struct ResultElementArray), 0, NULL, NULL, NULL);
	if (!a)
		return NULL;
	soap_default_ResultElementArray(soap, a);
	if (soap->body && !*soap->href)
	{
		a->__size = soap_getsize(soap->arraySize, soap->arrayOffset, &j);
		if (a->__size >= 0)
		{	a->__ptr = (struct api__ResultElement *)soap_malloc(soap, sizeof(struct api__ResultElement) * a->__size);
			for (i = 0; i < a->__size; i++)
				soap_default_api__ResultElement(soap, a->__ptr+i);
			for (i = 0; i < a->__size; i++)
			{	soap_peek_element(soap);
				if (soap->position)
				{	i = soap->positions[0]-j;
					if (i < 0 || i >= a->__size)
					{	soap->error = SOAP_IOB;
						return NULL;
					}
				}
				if (!soap_in_api__ResultElement(soap, NULL, a->__ptr + i, "api:ResultElement"))
				{	if (soap->error != SOAP_NO_TAG)
						return NULL;
					soap->error = SOAP_OK;
					break;
				}
			}
		}
		else
		{	soap_new_block(soap);
			for (a->__size = 0; ; a->__size++)
			{	p = (struct api__ResultElement *)soap_push_block(soap, sizeof(struct api__ResultElement));
				if (!p)
					return NULL;
				soap_default_api__ResultElement(soap, p);
				if (!soap_in_api__ResultElement(soap, NULL, p, "api:ResultElement"))
				{	if (soap->error != SOAP_NO_TAG)
						return NULL;
					soap->error = SOAP_OK;
					break;
				}
			}
			soap_pop_block(soap);
			a->__ptr = (struct api__ResultElement *)soap_malloc(soap, soap->blist->size);
			soap_save_block(soap, (char*)a->__ptr, 1);
		}
		if (soap_element_end_in(soap, tag))
			return NULL;
	}
	else
	{	a = (struct ResultElementArray *)soap_id_forward(soap, soap->href, (void**)a, SOAP_TYPE_ResultElementArray, 0, sizeof(struct ResultElementArray), 0, NULL);
		if (soap->body && soap_element_end_in(soap, tag))
			return NULL;
	}
	return a;
}

SOAP_FMAC3 void SOAP_FMAC4 soap_serialize_api__ResultElement(struct soap *soap, const struct api__ResultElement *a)
{
	(void)soap; (void)a; /* appease -Wall -Werror */
	soap_serialize_xsd__string(soap, &a->summary);
	soap_serialize_xsd__string(soap, &a->URL);
	soap_serialize_xsd__string(soap, &a->snippet);
	soap_serialize_xsd__string(soap, &a->title);
	soap_serialize_xsd__string(soap, &a->cachedSize);
	soap_serialize_xsd__string(soap, &a->hostName);
	soap_embedded(soap, &a->directoryCategory, SOAP_TYPE_api__DirectoryCategory);
	soap_serialize_api__DirectoryCategory(soap, &a->directoryCategory);
	soap_serialize_xsd__string(soap, &a->directoryTitle);
}

SOAP_FMAC3 void SOAP_FMAC4 soap_default_api__ResultElement(struct soap *soap, struct api__ResultElement *a)
{
	(void)soap; (void)a; /* appease -Wall -Werror */
	soap_default_xsd__string(soap, &a->summary);
	soap_default_xsd__string(soap, &a->URL);
	soap_default_xsd__string(soap, &a->snippet);
	soap_default_xsd__string(soap, &a->title);
	soap_default_xsd__string(soap, &a->cachedSize);
	soap_default_xsd__boolean(soap, &a->relatedInformationPresent);
	soap_default_xsd__string(soap, &a->hostName);
	soap_default_api__DirectoryCategory(soap, &a->directoryCategory);
	soap_default_xsd__string(soap, &a->directoryTitle);
}

SOAP_FMAC3 int SOAP_FMAC4 soap_put_api__ResultElement(struct soap *soap, const struct api__ResultElement *a, const char *tag, const char *type)
{
	register int id = soap_embed(soap, (void*)a, NULL, 0, tag, SOAP_TYPE_api__ResultElement);
	if (soap_out_api__ResultElement(soap, tag, id, a, type))
		return soap->error;
	return soap_putindependent(soap);
}

SOAP_FMAC3 int SOAP_FMAC4 soap_out_api__ResultElement(struct soap *soap, const char *tag, int id, const struct api__ResultElement *a, const char *type)
{
	soap_element_begin_out(soap, tag, soap_embedded_id(soap, id, a, SOAP_TYPE_api__ResultElement), type);
	soap_out_xsd__string(soap, "summary", -1, &a->summary, "");
	soap_out_xsd__string(soap, "URL", -1, &a->URL, "");
	soap_out_xsd__string(soap, "snippet", -1, &a->snippet, "");
	soap_out_xsd__string(soap, "title", -1, &a->title, "");
	soap_out_xsd__string(soap, "cachedSize", -1, &a->cachedSize, "");
	soap_out_xsd__boolean(soap, "relatedInformationPresent", -1, &a->relatedInformationPresent, "");
	soap_out_xsd__string(soap, "hostName", -1, &a->hostName, "");
	soap_out_api__DirectoryCategory(soap, "directoryCategory", -1, &a->directoryCategory, "");
	soap_out_xsd__string(soap, "directoryTitle", -1, &a->directoryTitle, "");
	soap_element_end_out(soap, tag);
	return SOAP_OK;
}

SOAP_FMAC3 struct api__ResultElement * SOAP_FMAC4 soap_get_api__ResultElement(struct soap *soap, struct api__ResultElement *p, const char *tag, const char *type)
{
	if ((p = soap_in_api__ResultElement(soap, tag, p, type)))
		soap_getindependent(soap);
	return p;
}

SOAP_FMAC3 struct api__ResultElement * SOAP_FMAC4 soap_in_api__ResultElement(struct soap *soap, const char *tag, struct api__ResultElement *a, const char *type)
{
	short soap_flag_summary = 1, soap_flag_URL = 1, soap_flag_snippet = 1, soap_flag_title = 1, soap_flag_cachedSize = 1, soap_flag_relatedInformationPresent = 1, soap_flag_hostName = 1, soap_flag_directoryCategory = 1, soap_flag_directoryTitle = 1;
	if (soap_element_begin_in(soap, tag, 0))
		return NULL;
	if (*soap->type && soap_match_tag(soap, soap->type, type))
	{	soap->error = SOAP_TYPE;
		return NULL;
	}
	a = (struct api__ResultElement *)soap_id_enter(soap, soap->id, a, SOAP_TYPE_api__ResultElement, sizeof(struct api__ResultElement), 0, NULL, NULL, NULL);
	if (!a)
		return NULL;
	soap_default_api__ResultElement(soap, a);
	if (soap->body && !*soap->href)
	{
		for (;;)
		{	soap->error = SOAP_TAG_MISMATCH;
			if (soap_flag_summary && (soap->error == SOAP_TAG_MISMATCH || soap->error == SOAP_NO_TAG))
				if (soap_in_xsd__string(soap, "summary", &a->summary, "xsd:string"))
				{	soap_flag_summary--;
					continue;
				}
			if (soap_flag_URL && (soap->error == SOAP_TAG_MISMATCH || soap->error == SOAP_NO_TAG))
				if (soap_in_xsd__string(soap, "URL", &a->URL, "xsd:string"))
				{	soap_flag_URL--;
					continue;
				}
			if (soap_flag_snippet && (soap->error == SOAP_TAG_MISMATCH || soap->error == SOAP_NO_TAG))
				if (soap_in_xsd__string(soap, "snippet", &a->snippet, "xsd:string"))
				{	soap_flag_snippet--;
					continue;
				}
			if (soap_flag_title && (soap->error == SOAP_TAG_MISMATCH || soap->error == SOAP_NO_TAG))
				if (soap_in_xsd__string(soap, "title", &a->title, "xsd:string"))
				{	soap_flag_title--;
					continue;
				}
			if (soap_flag_cachedSize && (soap->error == SOAP_TAG_MISMATCH || soap->error == SOAP_NO_TAG))
				if (soap_in_xsd__string(soap, "cachedSize", &a->cachedSize, "xsd:string"))
				{	soap_flag_cachedSize--;
					continue;
				}
			if (soap_flag_relatedInformationPresent && soap->error == SOAP_TAG_MISMATCH)
				if (soap_in_xsd__boolean(soap, "relatedInformationPresent", &a->relatedInformationPresent, "xsd:boolean"))
				{	soap_flag_relatedInformationPresent--;
					continue;
				}
			if (soap_flag_hostName && (soap->error == SOAP_TAG_MISMATCH || soap->error == SOAP_NO_TAG))
				if (soap_in_xsd__string(soap, "hostName", &a->hostName, "xsd:string"))
				{	soap_flag_hostName--;
					continue;
				}
			if (soap_flag_directoryCategory && soap->error == SOAP_TAG_MISMATCH)
				if (soap_in_api__DirectoryCategory(soap, "directoryCategory", &a->directoryCategory, "api:DirectoryCategory"))
				{	soap_flag_directoryCategory--;
					continue;
				}
			if (soap_flag_directoryTitle && (soap->error == SOAP_TAG_MISMATCH || soap->error == SOAP_NO_TAG))
				if (soap_in_xsd__string(soap, "directoryTitle", &a->directoryTitle, "xsd:string"))
				{	soap_flag_directoryTitle--;
					continue;
				}
			if (soap->error == SOAP_TAG_MISMATCH)
				soap->error = soap_ignore_element(soap);
			if (soap->error == SOAP_NO_TAG)
				break;
			if (soap->error)
				return NULL;
		}
		if ((soap->mode & SOAP_XML_STRICT) && (soap_flag_relatedInformationPresent > 0 || soap_flag_directoryCategory > 0))
		{	soap->error = SOAP_OCCURS;
			return NULL;
		}
		if (soap_element_end_in(soap, tag))
			return NULL;
	}
	else
	{	a = (struct api__ResultElement *)soap_id_forward(soap, soap->href, (void**)a, SOAP_TYPE_api__ResultElement, 0, sizeof(struct api__ResultElement), 0, NULL);
		if (soap->body && soap_element_end_in(soap, tag))
			return NULL;
	}
	return a;
}

SOAP_FMAC3 void SOAP_FMAC4 soap_serialize_DirectoryCategoryArray(struct soap *soap, struct DirectoryCategoryArray const*a)
{
	int i;
	if (a->__ptr && !soap_array_reference(soap, a, (struct soap_array*)&a->__ptr, 1, SOAP_TYPE_DirectoryCategoryArray))
		for (i = 0; i < a->__size; i++)
		{	soap_embedded(soap, a->__ptr + i, SOAP_TYPE_api__DirectoryCategory);
			soap_serialize_api__DirectoryCategory(soap, a->__ptr + i);
		}
}

SOAP_FMAC3 void SOAP_FMAC4 soap_default_DirectoryCategoryArray(struct soap *soap, struct DirectoryCategoryArray *a)
{
	a->__size = 0;
	a->__ptr = NULL;
}

SOAP_FMAC3 int SOAP_FMAC4 soap_put_DirectoryCategoryArray(struct soap *soap, const struct DirectoryCategoryArray *a, const char *tag, const char *type)
{
	register int id = soap_embed(soap, (void*)a, (struct soap_array*)&a->__ptr, 1, tag, SOAP_TYPE_DirectoryCategoryArray);
	if (soap_out_DirectoryCategoryArray(soap, tag, id, a, type))
		return soap->error;
	return soap_putindependent(soap);
}

SOAP_FMAC3 int SOAP_FMAC4 soap_out_DirectoryCategoryArray(struct soap *soap, const char *tag, int id, const struct DirectoryCategoryArray *a, const char *type)
{
	int i, n = a->__size;
	char *t = soap_putsize(soap, "api:DirectoryCategory", a->__size);
	id = soap_element_id(soap, tag, id, a, (struct soap_array*)&a->__ptr, 1, type, SOAP_TYPE_DirectoryCategoryArray);
	if (id < 0)
		return soap->error;
	soap_array_begin_out(soap, tag, id, t, NULL);
	for (i = 0; i < n; i++)
	{
		soap->position = 1;
		soap->positions[0] = i;
		soap_out_api__DirectoryCategory(soap, "item", -1, &a->__ptr[i], "");
	}
	soap->position = 0;
	soap_element_end_out(soap, tag);
	return SOAP_OK;
}

SOAP_FMAC3 struct DirectoryCategoryArray * SOAP_FMAC4 soap_get_DirectoryCategoryArray(struct soap *soap, struct DirectoryCategoryArray *p, const char *tag, const char *type)
{
	if ((p = soap_in_DirectoryCategoryArray(soap, tag, p, type)))
		soap_getindependent(soap);
	return p;
}

SOAP_FMAC3 struct DirectoryCategoryArray * SOAP_FMAC4 soap_in_DirectoryCategoryArray(struct soap *soap, const char *tag, struct DirectoryCategoryArray *a, const char *type)
{	int i, j;
	struct api__DirectoryCategory *p;
	if (soap_element_begin_in(soap, tag, 1))
		return NULL;
	if (soap_match_array(soap, type))
	{	soap->error = SOAP_TYPE;
		return NULL;
	}
	a = (struct DirectoryCategoryArray *)soap_id_enter(soap, soap->id, a, SOAP_TYPE_DirectoryCategoryArray, sizeof(struct DirectoryCategoryArray), 0, NULL, NULL, NULL);
	if (!a)
		return NULL;
	soap_default_DirectoryCategoryArray(soap, a);
	if (soap->body && !*soap->href)
	{
		a->__size = soap_getsize(soap->arraySize, soap->arrayOffset, &j);
		if (a->__size >= 0)
		{	a->__ptr = (struct api__DirectoryCategory *)soap_malloc(soap, sizeof(struct api__DirectoryCategory) * a->__size);
			for (i = 0; i < a->__size; i++)
				soap_default_api__DirectoryCategory(soap, a->__ptr+i);
			for (i = 0; i < a->__size; i++)
			{	soap_peek_element(soap);
				if (soap->position)
				{	i = soap->positions[0]-j;
					if (i < 0 || i >= a->__size)
					{	soap->error = SOAP_IOB;
						return NULL;
					}
				}
				if (!soap_in_api__DirectoryCategory(soap, NULL, a->__ptr + i, "api:DirectoryCategory"))
				{	if (soap->error != SOAP_NO_TAG)
						return NULL;
					soap->error = SOAP_OK;
					break;
				}
			}
		}
		else
		{	soap_new_block(soap);
			for (a->__size = 0; ; a->__size++)
			{	p = (struct api__DirectoryCategory *)soap_push_block(soap, sizeof(struct api__DirectoryCategory));
				if (!p)
					return NULL;
				soap_default_api__DirectoryCategory(soap, p);
				if (!soap_in_api__DirectoryCategory(soap, NULL, p, "api:DirectoryCategory"))
				{	if (soap->error != SOAP_NO_TAG)
						return NULL;
					soap->error = SOAP_OK;
					break;
				}
			}
			soap_pop_block(soap);
			a->__ptr = (struct api__DirectoryCategory *)soap_malloc(soap, soap->blist->size);
			soap_save_block(soap, (char*)a->__ptr, 1);
		}
		if (soap_element_end_in(soap, tag))
			return NULL;
	}
	else
	{	a = (struct DirectoryCategoryArray *)soap_id_forward(soap, soap->href, (void**)a, SOAP_TYPE_DirectoryCategoryArray, 0, sizeof(struct DirectoryCategoryArray), 0, NULL);
		if (soap->body && soap_element_end_in(soap, tag))
			return NULL;
	}
	return a;
}

SOAP_FMAC3 void SOAP_FMAC4 soap_serialize_api__DirectoryCategory(struct soap *soap, const struct api__DirectoryCategory *a)
{
	(void)soap; (void)a; /* appease -Wall -Werror */
	soap_serialize_xsd__string(soap, &a->fullViewableName);
	soap_serialize_xsd__string(soap, &a->specialEncoding);
}

SOAP_FMAC3 void SOAP_FMAC4 soap_default_api__DirectoryCategory(struct soap *soap, struct api__DirectoryCategory *a)
{
	(void)soap; (void)a; /* appease -Wall -Werror */
	soap_default_xsd__string(soap, &a->fullViewableName);
	soap_default_xsd__string(soap, &a->specialEncoding);
}

SOAP_FMAC3 int SOAP_FMAC4 soap_put_api__DirectoryCategory(struct soap *soap, const struct api__DirectoryCategory *a, const char *tag, const char *type)
{
	register int id = soap_embed(soap, (void*)a, NULL, 0, tag, SOAP_TYPE_api__DirectoryCategory);
	if (soap_out_api__DirectoryCategory(soap, tag, id, a, type))
		return soap->error;
	return soap_putindependent(soap);
}

SOAP_FMAC3 int SOAP_FMAC4 soap_out_api__DirectoryCategory(struct soap *soap, const char *tag, int id, const struct api__DirectoryCategory *a, const char *type)
{
	soap_element_begin_out(soap, tag, soap_embedded_id(soap, id, a, SOAP_TYPE_api__DirectoryCategory), type);
	soap_out_xsd__string(soap, "fullViewableName", -1, &a->fullViewableName, "");
	soap_out_xsd__string(soap, "specialEncoding", -1, &a->specialEncoding, "");
	soap_element_end_out(soap, tag);
	return SOAP_OK;
}

SOAP_FMAC3 struct api__DirectoryCategory * SOAP_FMAC4 soap_get_api__DirectoryCategory(struct soap *soap, struct api__DirectoryCategory *p, const char *tag, const char *type)
{
	if ((p = soap_in_api__DirectoryCategory(soap, tag, p, type)))
		soap_getindependent(soap);
	return p;
}

SOAP_FMAC3 struct api__DirectoryCategory * SOAP_FMAC4 soap_in_api__DirectoryCategory(struct soap *soap, const char *tag, struct api__DirectoryCategory *a, const char *type)
{
	short soap_flag_fullViewableName = 1, soap_flag_specialEncoding = 1;
	if (soap_element_begin_in(soap, tag, 0))
		return NULL;
	if (*soap->type && soap_match_tag(soap, soap->type, type))
	{	soap->error = SOAP_TYPE;
		return NULL;
	}
	a = (struct api__DirectoryCategory *)soap_id_enter(soap, soap->id, a, SOAP_TYPE_api__DirectoryCategory, sizeof(struct api__DirectoryCategory), 0, NULL, NULL, NULL);
	if (!a)
		return NULL;
	soap_default_api__DirectoryCategory(soap, a);
	if (soap->body && !*soap->href)
	{
		for (;;)
		{	soap->error = SOAP_TAG_MISMATCH;
			if (soap_flag_fullViewableName && (soap->error == SOAP_TAG_MISMATCH || soap->error == SOAP_NO_TAG))
				if (soap_in_xsd__string(soap, "fullViewableName", &a->fullViewableName, "xsd:string"))
				{	soap_flag_fullViewableName--;
					continue;
				}
			if (soap_flag_specialEncoding && (soap->error == SOAP_TAG_MISMATCH || soap->error == SOAP_NO_TAG))
				if (soap_in_xsd__string(soap, "specialEncoding", &a->specialEncoding, "xsd:string"))
				{	soap_flag_specialEncoding--;
					continue;
				}
			if (soap->error == SOAP_TAG_MISMATCH)
				soap->error = soap_ignore_element(soap);
			if (soap->error == SOAP_NO_TAG)
				break;
			if (soap->error)
				return NULL;
		}
		if (soap_element_end_in(soap, tag))
			return NULL;
	}
	else
	{	a = (struct api__DirectoryCategory *)soap_id_forward(soap, soap->href, (void**)a, SOAP_TYPE_api__DirectoryCategory, 0, sizeof(struct api__DirectoryCategory), 0, NULL);
		if (soap->body && soap_element_end_in(soap, tag))
			return NULL;
	}
	return a;
}

SOAP_FMAC3 void SOAP_FMAC4 soap_serialize_xsd__base64Binary(struct soap *soap, struct xsd__base64Binary const*a)
{
	if (a->__ptr)
		soap_array_reference(soap, a, (struct soap_array*)&a->__ptr, 1, SOAP_TYPE_xsd__base64Binary);
}

SOAP_FMAC3 void SOAP_FMAC4 soap_default_xsd__base64Binary(struct soap *soap, struct xsd__base64Binary *a)
{
	a->__size = 0;
	a->__ptr = NULL;
}

SOAP_FMAC3 int SOAP_FMAC4 soap_put_xsd__base64Binary(struct soap *soap, const struct xsd__base64Binary *a, const char *tag, const char *type)
{
	register int id = soap_embed(soap, (void*)a, (struct soap_array*)&a->__ptr, 1, tag, SOAP_TYPE_xsd__base64Binary);
	if (soap_out_xsd__base64Binary(soap, tag, id, a, type))
		return soap->error;
	return soap_putindependent(soap);
}

SOAP_FMAC3 int SOAP_FMAC4 soap_out_xsd__base64Binary(struct soap *soap, const char *tag, int id, const struct xsd__base64Binary *a, const char *type)
{
	id = soap_element_id(soap, tag, id, a, (struct soap_array*)&a->__ptr, 1, type, SOAP_TYPE_xsd__base64Binary);
	if (id < 0)
		return soap->error;
	soap_element_begin_out(soap, tag, id, type);
	soap_putbase64(soap, a->__ptr, a->__size);
	soap_element_end_out(soap, tag);
	return SOAP_OK;
}

SOAP_FMAC3 struct xsd__base64Binary * SOAP_FMAC4 soap_get_xsd__base64Binary(struct soap *soap, struct xsd__base64Binary *p, const char *tag, const char *type)
{
	if ((p = soap_in_xsd__base64Binary(soap, tag, p, type)))
		soap_getindependent(soap);
	return p;
}

SOAP_FMAC3 struct xsd__base64Binary * SOAP_FMAC4 soap_in_xsd__base64Binary(struct soap *soap, const char *tag, struct xsd__base64Binary *a, const char *type)
{
	if (soap_element_begin_in(soap, tag, 1))
		return NULL;
	if (*soap->type && soap_match_tag(soap, soap->type, type) && soap_match_tag(soap, soap->type, ":base64Binary") && soap_match_tag(soap, soap->type, ":base64"))
	{	soap->error = SOAP_TYPE;
		return NULL;
	}
	a = (struct xsd__base64Binary *)soap_id_enter(soap, soap->id, a, SOAP_TYPE_xsd__base64Binary, sizeof(struct xsd__base64Binary), 0, NULL, NULL, NULL);
	if (!a)
		return NULL;
	soap_default_xsd__base64Binary(soap, a);
	if (soap->body && !*soap->href)
	{
		a->__ptr = soap_getbase64(soap, &a->__size, 0);
		if ((!a->__ptr && soap->error) || soap_element_end_in(soap, tag))
			return NULL;
	}
	else
	{	a = (struct xsd__base64Binary *)soap_id_forward(soap, soap->href, (void**)a, SOAP_TYPE_xsd__base64Binary, 0, sizeof(struct xsd__base64Binary), 0, NULL);
		if (soap->body && soap_element_end_in(soap, tag))
			return NULL;
	}
	return a;
}

SOAP_FMAC3 void SOAP_FMAC4 soap_serialize_PointerToSOAP_ENV__Reason(struct soap *soap, struct SOAP_ENV__Reason *const*a)
{
	if (!soap_reference(soap, *a, SOAP_TYPE_SOAP_ENV__Reason))
		soap_serialize_SOAP_ENV__Reason(soap, *a);
}

SOAP_FMAC3 int SOAP_FMAC4 soap_put_PointerToSOAP_ENV__Reason(struct soap *soap, struct SOAP_ENV__Reason *const*a, const char *tag, const char *type)
{
	register int id = soap_embed(soap, (void*)a, NULL, 0, tag, SOAP_TYPE_PointerToSOAP_ENV__Reason);
	if (soap_out_PointerToSOAP_ENV__Reason(soap, tag, id, a, type))
		return soap->error;
	return soap_putindependent(soap);
}

SOAP_FMAC3 int SOAP_FMAC4 soap_out_PointerToSOAP_ENV__Reason(struct soap *soap, const char *tag, int id, struct SOAP_ENV__Reason *const*a, const char *type)
{
	id = soap_element_id(soap, tag, id, *a, NULL, 0, type, SOAP_TYPE_SOAP_ENV__Reason);
	if (id < 0)
		return soap->error;
	return soap_out_SOAP_ENV__Reason(soap, tag, id, *a, type);
}

SOAP_FMAC3 struct SOAP_ENV__Reason ** SOAP_FMAC4 soap_get_PointerToSOAP_ENV__Reason(struct soap *soap, struct SOAP_ENV__Reason **p, const char *tag, const char *type)
{
	if ((p = soap_in_PointerToSOAP_ENV__Reason(soap, tag, p, type)))
		soap_getindependent(soap);
	return p;
}

SOAP_FMAC3 struct SOAP_ENV__Reason ** SOAP_FMAC4 soap_in_PointerToSOAP_ENV__Reason(struct soap *soap, const char *tag, struct SOAP_ENV__Reason **a, const char *type)
{
	if (soap_element_begin_in(soap, tag, 1))
		return NULL;
	if (!a)
		if (!(a = (struct SOAP_ENV__Reason **)soap_malloc(soap, sizeof(struct SOAP_ENV__Reason *))))
			return NULL;
	*a = NULL;
	if (!soap->null && *soap->href != '#')
	{	soap_revert(soap);
		if (!(*a = soap_in_SOAP_ENV__Reason(soap, tag, *a, type)))
			return NULL;
	}
	else
	{	a = (struct SOAP_ENV__Reason **)soap_id_lookup(soap, soap->href, (void**)a, SOAP_TYPE_SOAP_ENV__Reason, sizeof(struct SOAP_ENV__Reason), 0);
		if (soap->body && soap_element_end_in(soap, tag))
			return NULL;
	}
	return a;
}

#ifndef WITH_NOGLOBAL

SOAP_FMAC3 void SOAP_FMAC4 soap_serialize_PointerToSOAP_ENV__Detail(struct soap *soap, struct SOAP_ENV__Detail *const*a)
{
	if (!soap_reference(soap, *a, SOAP_TYPE_SOAP_ENV__Detail))
		soap_serialize_SOAP_ENV__Detail(soap, *a);
}

SOAP_FMAC3 int SOAP_FMAC4 soap_put_PointerToSOAP_ENV__Detail(struct soap *soap, struct SOAP_ENV__Detail *const*a, const char *tag, const char *type)
{
	register int id = soap_embed(soap, (void*)a, NULL, 0, tag, SOAP_TYPE_PointerToSOAP_ENV__Detail);
	if (soap_out_PointerToSOAP_ENV__Detail(soap, tag, id, a, type))
		return soap->error;
	return soap_putindependent(soap);
}

SOAP_FMAC3 int SOAP_FMAC4 soap_out_PointerToSOAP_ENV__Detail(struct soap *soap, const char *tag, int id, struct SOAP_ENV__Detail *const*a, const char *type)
{
	id = soap_element_id(soap, tag, id, *a, NULL, 0, type, SOAP_TYPE_SOAP_ENV__Detail);
	if (id < 0)
		return soap->error;
	return soap_out_SOAP_ENV__Detail(soap, tag, id, *a, type);
}

SOAP_FMAC3 struct SOAP_ENV__Detail ** SOAP_FMAC4 soap_get_PointerToSOAP_ENV__Detail(struct soap *soap, struct SOAP_ENV__Detail **p, const char *tag, const char *type)
{
	if ((p = soap_in_PointerToSOAP_ENV__Detail(soap, tag, p, type)))
		soap_getindependent(soap);
	return p;
}

SOAP_FMAC3 struct SOAP_ENV__Detail ** SOAP_FMAC4 soap_in_PointerToSOAP_ENV__Detail(struct soap *soap, const char *tag, struct SOAP_ENV__Detail **a, const char *type)
{
	if (soap_element_begin_in(soap, tag, 1))
		return NULL;
	if (!a)
		if (!(a = (struct SOAP_ENV__Detail **)soap_malloc(soap, sizeof(struct SOAP_ENV__Detail *))))
			return NULL;
	*a = NULL;
	if (!soap->null && *soap->href != '#')
	{	soap_revert(soap);
		if (!(*a = soap_in_SOAP_ENV__Detail(soap, tag, *a, type)))
			return NULL;
	}
	else
	{	a = (struct SOAP_ENV__Detail **)soap_id_lookup(soap, soap->href, (void**)a, SOAP_TYPE_SOAP_ENV__Detail, sizeof(struct SOAP_ENV__Detail), 0);
		if (soap->body && soap_element_end_in(soap, tag))
			return NULL;
	}
	return a;
}

#endif

#ifndef WITH_NOGLOBAL

SOAP_FMAC3 void SOAP_FMAC4 soap_serialize_PointerToSOAP_ENV__Code(struct soap *soap, struct SOAP_ENV__Code *const*a)
{
	if (!soap_reference(soap, *a, SOAP_TYPE_SOAP_ENV__Code))
		soap_serialize_SOAP_ENV__Code(soap, *a);
}

SOAP_FMAC3 int SOAP_FMAC4 soap_put_PointerToSOAP_ENV__Code(struct soap *soap, struct SOAP_ENV__Code *const*a, const char *tag, const char *type)
{
	register int id = soap_embed(soap, (void*)a, NULL, 0, tag, SOAP_TYPE_PointerToSOAP_ENV__Code);
	if (soap_out_PointerToSOAP_ENV__Code(soap, tag, id, a, type))
		return soap->error;
	return soap_putindependent(soap);
}

SOAP_FMAC3 int SOAP_FMAC4 soap_out_PointerToSOAP_ENV__Code(struct soap *soap, const char *tag, int id, struct SOAP_ENV__Code *const*a, const char *type)
{
	id = soap_element_id(soap, tag, id, *a, NULL, 0, type, SOAP_TYPE_SOAP_ENV__Code);
	if (id < 0)
		return soap->error;
	return soap_out_SOAP_ENV__Code(soap, tag, id, *a, type);
}

SOAP_FMAC3 struct SOAP_ENV__Code ** SOAP_FMAC4 soap_get_PointerToSOAP_ENV__Code(struct soap *soap, struct SOAP_ENV__Code **p, const char *tag, const char *type)
{
	if ((p = soap_in_PointerToSOAP_ENV__Code(soap, tag, p, type)))
		soap_getindependent(soap);
	return p;
}

SOAP_FMAC3 struct SOAP_ENV__Code ** SOAP_FMAC4 soap_in_PointerToSOAP_ENV__Code(struct soap *soap, const char *tag, struct SOAP_ENV__Code **a, const char *type)
{
	if (soap_element_begin_in(soap, tag, 1))
		return NULL;
	if (!a)
		if (!(a = (struct SOAP_ENV__Code **)soap_malloc(soap, sizeof(struct SOAP_ENV__Code *))))
			return NULL;
	*a = NULL;
	if (!soap->null && *soap->href != '#')
	{	soap_revert(soap);
		if (!(*a = soap_in_SOAP_ENV__Code(soap, tag, *a, type)))
			return NULL;
	}
	else
	{	a = (struct SOAP_ENV__Code **)soap_id_lookup(soap, soap->href, (void**)a, SOAP_TYPE_SOAP_ENV__Code, sizeof(struct SOAP_ENV__Code), 0);
		if (soap->body && soap_element_end_in(soap, tag))
			return NULL;
	}
	return a;
}

#endif

SOAP_FMAC3 void SOAP_FMAC4 soap_serialize_PointerToxsd__string(struct soap *soap, char **const*a)
{
	if (!soap_reference(soap, *a, SOAP_TYPE_xsd__string))
		soap_serialize_xsd__string(soap, *a);
}

SOAP_FMAC3 int SOAP_FMAC4 soap_put_PointerToxsd__string(struct soap *soap, char **const*a, const char *tag, const char *type)
{
	register int id = soap_embed(soap, (void*)a, NULL, 0, tag, SOAP_TYPE_PointerToxsd__string);
	if (soap_out_PointerToxsd__string(soap, tag, id, a, type))
		return soap->error;
	return soap_putindependent(soap);
}

SOAP_FMAC3 int SOAP_FMAC4 soap_out_PointerToxsd__string(struct soap *soap, const char *tag, int id, char **const*a, const char *type)
{
	id = soap_element_id(soap, tag, id, *a, NULL, 0, type, SOAP_TYPE_xsd__string);
	if (id < 0)
		return soap->error;
	return soap_out_xsd__string(soap, tag, id, *a, type);
}

SOAP_FMAC3 char *** SOAP_FMAC4 soap_get_PointerToxsd__string(struct soap *soap, char ***p, const char *tag, const char *type)
{
	if ((p = soap_in_PointerToxsd__string(soap, tag, p, type)))
		soap_getindependent(soap);
	return p;
}

SOAP_FMAC3 char *** SOAP_FMAC4 soap_in_PointerToxsd__string(struct soap *soap, const char *tag, char ***a, const char *type)
{
	if (soap_element_begin_in(soap, tag, 1))
		return NULL;
	if (!a)
		if (!(a = (char ***)soap_malloc(soap, sizeof(char **))))
			return NULL;
	*a = NULL;
	if (!soap->null && *soap->href != '#')
	{	soap_revert(soap);
		if (!(*a = soap_in_xsd__string(soap, tag, *a, type)))
			return NULL;
	}
	else
	{	a = (char ***)soap_id_lookup(soap, soap->href, (void**)a, SOAP_TYPE_xsd__string, sizeof(char *), 1);
		if (soap->body && soap_element_end_in(soap, tag))
			return NULL;
	}
	return a;
}

SOAP_FMAC3 void SOAP_FMAC4 soap_serialize_PointerToxsd__base64Binary(struct soap *soap, struct xsd__base64Binary *const*a)
{
	if (*a)
		soap_serialize_xsd__base64Binary(soap, *a);
}

SOAP_FMAC3 int SOAP_FMAC4 soap_put_PointerToxsd__base64Binary(struct soap *soap, struct xsd__base64Binary *const*a, const char *tag, const char *type)
{
	register int id = soap_embed(soap, (void*)a, NULL, 0, tag, SOAP_TYPE_PointerToxsd__base64Binary);
	if (soap_out_PointerToxsd__base64Binary(soap, tag, id, a, type))
		return soap->error;
	return soap_putindependent(soap);
}

SOAP_FMAC3 int SOAP_FMAC4 soap_out_PointerToxsd__base64Binary(struct soap *soap, const char *tag, int id, struct xsd__base64Binary *const*a, const char *type)
{
	id = soap_element_id(soap, tag, id, *a, (struct soap_array*)&(*a)->__ptr, 1, type, SOAP_TYPE_xsd__base64Binary);
	if (id < 0)
		return soap->error;
	return soap_out_xsd__base64Binary(soap, tag, id, *a, type);
}

SOAP_FMAC3 struct xsd__base64Binary ** SOAP_FMAC4 soap_get_PointerToxsd__base64Binary(struct soap *soap, struct xsd__base64Binary **p, const char *tag, const char *type)
{
	if ((p = soap_in_PointerToxsd__base64Binary(soap, tag, p, type)))
		soap_getindependent(soap);
	return p;
}

SOAP_FMAC3 struct xsd__base64Binary ** SOAP_FMAC4 soap_in_PointerToxsd__base64Binary(struct soap *soap, const char *tag, struct xsd__base64Binary **a, const char *type)
{
	if (soap_element_begin_in(soap, tag, 1))
		return NULL;
	if (!a)
		if (!(a = (struct xsd__base64Binary **)soap_malloc(soap, sizeof(struct xsd__base64Binary *))))
			return NULL;
	*a = NULL;
	if (!soap->null && *soap->href != '#')
	{	soap_revert(soap);
		if (!(*a = soap_in_xsd__base64Binary(soap, tag, *a, type)))
			return NULL;
	}
	else
	{	a = (struct xsd__base64Binary **)soap_id_lookup(soap, soap->href, (void**)a, SOAP_TYPE_xsd__base64Binary, sizeof(struct xsd__base64Binary), 0);
		if (soap->body && soap_element_end_in(soap, tag))
			return NULL;
	}
	return a;
}

SOAP_FMAC3 void SOAP_FMAC4 soap_serialize_PointerToapi__doGoogleSearchResponse(struct soap *soap, struct api__doGoogleSearchResponse *const*a)
{
	if (!soap_reference(soap, *a, SOAP_TYPE_api__doGoogleSearchResponse))
		soap_serialize_api__doGoogleSearchResponse(soap, *a);
}

SOAP_FMAC3 int SOAP_FMAC4 soap_put_PointerToapi__doGoogleSearchResponse(struct soap *soap, struct api__doGoogleSearchResponse *const*a, const char *tag, const char *type)
{
	register int id = soap_embed(soap, (void*)a, NULL, 0, tag, SOAP_TYPE_PointerToapi__doGoogleSearchResponse);
	if (soap_out_PointerToapi__doGoogleSearchResponse(soap, tag, id, a, type))
		return soap->error;
	return soap_putindependent(soap);
}

SOAP_FMAC3 int SOAP_FMAC4 soap_out_PointerToapi__doGoogleSearchResponse(struct soap *soap, const char *tag, int id, struct api__doGoogleSearchResponse *const*a, const char *type)
{
	id = soap_element_id(soap, tag, id, *a, NULL, 0, type, SOAP_TYPE_api__doGoogleSearchResponse);
	if (id < 0)
		return soap->error;
	return soap_out_api__doGoogleSearchResponse(soap, tag, id, *a, type);
}

SOAP_FMAC3 struct api__doGoogleSearchResponse ** SOAP_FMAC4 soap_get_PointerToapi__doGoogleSearchResponse(struct soap *soap, struct api__doGoogleSearchResponse **p, const char *tag, const char *type)
{
	if ((p = soap_in_PointerToapi__doGoogleSearchResponse(soap, tag, p, type)))
		soap_getindependent(soap);
	return p;
}

SOAP_FMAC3 struct api__doGoogleSearchResponse ** SOAP_FMAC4 soap_in_PointerToapi__doGoogleSearchResponse(struct soap *soap, const char *tag, struct api__doGoogleSearchResponse **a, const char *type)
{
	if (soap_element_begin_in(soap, tag, 1))
		return NULL;
	if (!a)
		if (!(a = (struct api__doGoogleSearchResponse **)soap_malloc(soap, sizeof(struct api__doGoogleSearchResponse *))))
			return NULL;
	*a = NULL;
	if (!soap->null && *soap->href != '#')
	{	soap_revert(soap);
		if (!(*a = soap_in_api__doGoogleSearchResponse(soap, tag, *a, type)))
			return NULL;
	}
	else
	{	a = (struct api__doGoogleSearchResponse **)soap_id_lookup(soap, soap->href, (void**)a, SOAP_TYPE_api__doGoogleSearchResponse, sizeof(struct api__doGoogleSearchResponse), 0);
		if (soap->body && soap_element_end_in(soap, tag))
			return NULL;
	}
	return a;
}

SOAP_FMAC3 void SOAP_FMAC4 soap_serialize_PointerToapi__ResultElement(struct soap *soap, struct api__ResultElement *const*a)
{
	if (!soap_reference(soap, *a, SOAP_TYPE_api__ResultElement))
		soap_serialize_api__ResultElement(soap, *a);
}

SOAP_FMAC3 int SOAP_FMAC4 soap_put_PointerToapi__ResultElement(struct soap *soap, struct api__ResultElement *const*a, const char *tag, const char *type)
{
	register int id = soap_embed(soap, (void*)a, NULL, 0, tag, SOAP_TYPE_PointerToapi__ResultElement);
	if (soap_out_PointerToapi__ResultElement(soap, tag, id, a, type))
		return soap->error;
	return soap_putindependent(soap);
}

SOAP_FMAC3 int SOAP_FMAC4 soap_out_PointerToapi__ResultElement(struct soap *soap, const char *tag, int id, struct api__ResultElement *const*a, const char *type)
{
	id = soap_element_id(soap, tag, id, *a, NULL, 0, type, SOAP_TYPE_api__ResultElement);
	if (id < 0)
		return soap->error;
	return soap_out_api__ResultElement(soap, tag, id, *a, type);
}

SOAP_FMAC3 struct api__ResultElement ** SOAP_FMAC4 soap_get_PointerToapi__ResultElement(struct soap *soap, struct api__ResultElement **p, const char *tag, const char *type)
{
	if ((p = soap_in_PointerToapi__ResultElement(soap, tag, p, type)))
		soap_getindependent(soap);
	return p;
}

SOAP_FMAC3 struct api__ResultElement ** SOAP_FMAC4 soap_in_PointerToapi__ResultElement(struct soap *soap, const char *tag, struct api__ResultElement **a, const char *type)
{
	if (soap_element_begin_in(soap, tag, 1))
		return NULL;
	if (!a)
		if (!(a = (struct api__ResultElement **)soap_malloc(soap, sizeof(struct api__ResultElement *))))
			return NULL;
	*a = NULL;
	if (!soap->null && *soap->href != '#')
	{	soap_revert(soap);
		if (!(*a = soap_in_api__ResultElement(soap, tag, *a, type)))
			return NULL;
	}
	else
	{	a = (struct api__ResultElement **)soap_id_lookup(soap, soap->href, (void**)a, SOAP_TYPE_api__ResultElement, sizeof(struct api__ResultElement), 0);
		if (soap->body && soap_element_end_in(soap, tag))
			return NULL;
	}
	return a;
}

SOAP_FMAC3 void SOAP_FMAC4 soap_serialize_PointerToapi__DirectoryCategory(struct soap *soap, struct api__DirectoryCategory *const*a)
{
	if (!soap_reference(soap, *a, SOAP_TYPE_api__DirectoryCategory))
		soap_serialize_api__DirectoryCategory(soap, *a);
}

SOAP_FMAC3 int SOAP_FMAC4 soap_put_PointerToapi__DirectoryCategory(struct soap *soap, struct api__DirectoryCategory *const*a, const char *tag, const char *type)
{
	register int id = soap_embed(soap, (void*)a, NULL, 0, tag, SOAP_TYPE_PointerToapi__DirectoryCategory);
	if (soap_out_PointerToapi__DirectoryCategory(soap, tag, id, a, type))
		return soap->error;
	return soap_putindependent(soap);
}

SOAP_FMAC3 int SOAP_FMAC4 soap_out_PointerToapi__DirectoryCategory(struct soap *soap, const char *tag, int id, struct api__DirectoryCategory *const*a, const char *type)
{
	id = soap_element_id(soap, tag, id, *a, NULL, 0, type, SOAP_TYPE_api__DirectoryCategory);
	if (id < 0)
		return soap->error;
	return soap_out_api__DirectoryCategory(soap, tag, id, *a, type);
}

SOAP_FMAC3 struct api__DirectoryCategory ** SOAP_FMAC4 soap_get_PointerToapi__DirectoryCategory(struct soap *soap, struct api__DirectoryCategory **p, const char *tag, const char *type)
{
	if ((p = soap_in_PointerToapi__DirectoryCategory(soap, tag, p, type)))
		soap_getindependent(soap);
	return p;
}

SOAP_FMAC3 struct api__DirectoryCategory ** SOAP_FMAC4 soap_in_PointerToapi__DirectoryCategory(struct soap *soap, const char *tag, struct api__DirectoryCategory **a, const char *type)
{
	if (soap_element_begin_in(soap, tag, 1))
		return NULL;
	if (!a)
		if (!(a = (struct api__DirectoryCategory **)soap_malloc(soap, sizeof(struct api__DirectoryCategory *))))
			return NULL;
	*a = NULL;
	if (!soap->null && *soap->href != '#')
	{	soap_revert(soap);
		if (!(*a = soap_in_api__DirectoryCategory(soap, tag, *a, type)))
			return NULL;
	}
	else
	{	a = (struct api__DirectoryCategory **)soap_id_lookup(soap, soap->href, (void**)a, SOAP_TYPE_api__DirectoryCategory, sizeof(struct api__DirectoryCategory), 0);
		if (soap->body && soap_element_end_in(soap, tag))
			return NULL;
	}
	return a;
}

SOAP_FMAC3 void SOAP_FMAC4 soap_serialize_PointerTounsignedByte(struct soap *soap, unsigned char *const*a)
{
	soap_reference(soap, *a, SOAP_TYPE_unsignedByte);
}

SOAP_FMAC3 int SOAP_FMAC4 soap_put_PointerTounsignedByte(struct soap *soap, unsigned char *const*a, const char *tag, const char *type)
{
	register int id = soap_embed(soap, (void*)a, NULL, 0, tag, SOAP_TYPE_PointerTounsignedByte);
	if (soap_out_PointerTounsignedByte(soap, tag, id, a, type))
		return soap->error;
	return soap_putindependent(soap);
}

SOAP_FMAC3 int SOAP_FMAC4 soap_out_PointerTounsignedByte(struct soap *soap, const char *tag, int id, unsigned char *const*a, const char *type)
{
	id = soap_element_id(soap, tag, id, *a, NULL, 0, type, SOAP_TYPE_unsignedByte);
	if (id < 0)
		return soap->error;
	return soap_out_unsignedByte(soap, tag, id, *a, type);
}

SOAP_FMAC3 unsigned char ** SOAP_FMAC4 soap_get_PointerTounsignedByte(struct soap *soap, unsigned char **p, const char *tag, const char *type)
{
	if ((p = soap_in_PointerTounsignedByte(soap, tag, p, type)))
		soap_getindependent(soap);
	return p;
}

SOAP_FMAC3 unsigned char ** SOAP_FMAC4 soap_in_PointerTounsignedByte(struct soap *soap, const char *tag, unsigned char **a, const char *type)
{
	if (soap_element_begin_in(soap, tag, 1))
		return NULL;
	if (!a)
		if (!(a = (unsigned char **)soap_malloc(soap, sizeof(unsigned char *))))
			return NULL;
	*a = NULL;
	if (!soap->null && *soap->href != '#')
	{	soap_revert(soap);
		if (!(*a = soap_in_unsignedByte(soap, tag, *a, type)))
			return NULL;
	}
	else
	{	a = (unsigned char **)soap_id_lookup(soap, soap->href, (void**)a, SOAP_TYPE_unsignedByte, sizeof(unsigned char), 0);
		if (soap->body && soap_element_end_in(soap, tag))
			return NULL;
	}
	return a;
}

SOAP_FMAC3 void SOAP_FMAC4 soap_default_xsd__string(struct soap *soap, char **a)
{	soap_default_string(soap, a);
}

SOAP_FMAC3 void SOAP_FMAC4 soap_serialize_xsd__string(struct soap *soap, char *const*a)
{	soap_serialize_string(soap, a);
}

SOAP_FMAC3 int SOAP_FMAC4 soap_put_xsd__string(struct soap *soap, char *const*a, const char *tag, const char *type)
{
	register int id = soap_embed(soap, (void*)a, NULL, 0, tag, SOAP_TYPE_xsd__string);
	if (soap_out_xsd__string(soap, tag, id, a, type))
		return soap->error;
	return soap_putindependent(soap);
}

SOAP_FMAC3 int SOAP_FMAC4 soap_out_xsd__string(struct soap *soap, const char *tag, int id, char *const*a, const char *type)
{
	return soap_outstring(soap, tag, id, a, type, SOAP_TYPE_xsd__string);
}

SOAP_FMAC3 char ** SOAP_FMAC4 soap_get_xsd__string(struct soap *soap, char **p, const char *tag, const char *type)
{
	if ((p = soap_in_xsd__string(soap, tag, p, type)))
		soap_getindependent(soap);
	return p;
}

SOAP_FMAC3 char * * SOAP_FMAC4 soap_in_xsd__string(struct soap *soap, const char *tag, char **a, const char *type)
{
	return soap_instring(soap, tag, a, type, SOAP_TYPE_xsd__string, 1, -1, -1);
}

SOAP_FMAC3 void SOAP_FMAC4 soap_default__QName(struct soap *soap, char **a)
{	soap_default_string(soap, a);
}

SOAP_FMAC3 void SOAP_FMAC4 soap_serialize__QName(struct soap *soap, char *const*a)
{	soap_serialize_string(soap, a);
}

SOAP_FMAC3 int SOAP_FMAC4 soap_put__QName(struct soap *soap, char *const*a, const char *tag, const char *type)
{
	register int id = soap_embed(soap, (void*)a, NULL, 0, tag, SOAP_TYPE__QName);
	if (soap_out__QName(soap, tag, id, a, type))
		return soap->error;
	return soap_putindependent(soap);
}

SOAP_FMAC3 int SOAP_FMAC4 soap_out__QName(struct soap *soap, const char *tag, int id, char *const*a, const char *type)
{
	return soap_outstring(soap, tag, id, a, type, SOAP_TYPE__QName);
}

SOAP_FMAC3 char ** SOAP_FMAC4 soap_get__QName(struct soap *soap, char **p, const char *tag, const char *type)
{
	if ((p = soap_in__QName(soap, tag, p, type)))
		soap_getindependent(soap);
	return p;
}

SOAP_FMAC3 char * * SOAP_FMAC4 soap_in__QName(struct soap *soap, const char *tag, char **a, const char *type)
{
	return soap_instring(soap, tag, a, type, SOAP_TYPE__QName, 2, -1, -1);
}

SOAP_FMAC3 void SOAP_FMAC4 soap_default_string(struct soap *soap, char **a)
{	(void)soap; /* appease -Wall -Werror */
#ifdef SOAP_DEFAULT_string
	*a = SOAP_DEFAULT_string;
#else
	*a = (char *)0;
#endif
}

SOAP_FMAC3 void SOAP_FMAC4 soap_serialize_string(struct soap *soap, char *const*a)
{
	soap_reference(soap, *a, SOAP_TYPE_string);
}

SOAP_FMAC3 int SOAP_FMAC4 soap_put_string(struct soap *soap, char *const*a, const char *tag, const char *type)
{
	register int id = soap_embed(soap, (void*)a, NULL, 0, tag, SOAP_TYPE_string);
	if (soap_out_string(soap, tag, id, a, type))
		return soap->error;
	return soap_putindependent(soap);
}

SOAP_FMAC3 int SOAP_FMAC4 soap_out_string(struct soap *soap, const char *tag, int id, char *const*a, const char *type)
{
	return soap_outstring(soap, tag, id, a, type, SOAP_TYPE_string);
}

SOAP_FMAC3 char ** SOAP_FMAC4 soap_get_string(struct soap *soap, char **p, const char *tag, const char *type)
{
	if ((p = soap_in_string(soap, tag, p, type)))
		soap_getindependent(soap);
	return p;
}

SOAP_FMAC3 char * * SOAP_FMAC4 soap_in_string(struct soap *soap, const char *tag, char **a, const char *type)
{
	return soap_instring(soap, tag, a, type, SOAP_TYPE_string, 1, -1, -1);
}

#ifdef __cplusplus
}
#endif

/* End of soapC.c */
